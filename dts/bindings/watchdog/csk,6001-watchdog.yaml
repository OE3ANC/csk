## dts/bindings/watchdog/csk,6001-watchdog.yaml
```yaml
# Copyright (c) 2022 listenai
# SPDX-License-Identifier: Apache-2.0

description: listenai csk6001 watchdog

compatible: "listenai,csk6001-watchdog"

include: base.yaml

properties:
    reg:
      required: true

    label:
      required: true
```

## dts/bindings/wifi/wifi,esp32c3.yaml
```yaml
# SPDX-License-Identifier: Apache-2.0

description: esp-hosted wifi module

compatible: "wifi,esp32c3"

properties:
    spi_port:
      type: int
      required: true
      enum:
       - 0
       - 1

    dataready-gpios:
      type: phandle-array
      required: true

    handshake-gpios:
      type: phandle-array
      required: true

    reset-gpios:
      type: phandle-array
      required: true

    label:
      required: true
      type: string
```

## modules/Kconfig
```kconfig
rsource "mbedtls/Kconfig"
rsource "esp_hosted_glue/Kconfig"
rsource "csk6_cm33/Kconfig"
rsource "csk_heap/Kconfig"
```

## modules/Kconfig.esp_hosted
```kconfig
# SPDX-License-Identifier: Apache-2.0

menuconfig ESP_HOSTED
	bool "ESP-Hosted support"

if ESP_HOSTED

config HOSTED_DATA_READY_PIN
	int "Data Ready Pin"
	default 4

config HOSTED_HANDSHAKE_PIN
	int "Handshake pin"
	default 5

config HOSTED_RESET_PIN
	int "Reset pin"
	default 9

config HOSTED_SPI_NUM
	int "SPI number"
	default 0
	range 0 1

config HOSTED_TRANSACTION_STACK
	int "Hosted Transaction Thread Stack"
	default 2048

config HOSTED_TRANSACTION_PRIORITY
	int "Hosted Transaction Thread priority"
	default 4

config HOSTED_PROCESS_RX_STACK
	int "Hosted Processing Thread Stack"
	default 2048

config HOSTED_PROCESS_RX_PRIORITY
	int "Hosted Processing Thread priority"
	default 5

endif # ESP_HOSTED
```

## modules/Kconfig.wifi_manager
```kconfig
# SPDX-License-Identifier: Apache-2.0

menuconfig WIFI_MANAGER
	bool "ESP-Hosted support"
	select NVS
	select FLASH
	select FLASH_PAGE_LAYOUT
	select FLASH_MAP
	select MPU_ALLOW_FLASH_WRITE


if WIFI_MANAGER
	module = WIFI_MANAGER
	module-str = wifi_manager
	source "subsys/logging/Kconfig.template.log_config"
endif
```

## modules/Kconfig.xradio_819s
```kconfig
# SPDX-License-Identifier: Apache-2.0

menuconfig XR819S
	bool "XR819S support"
	select FLASH
	select FLASH_MAP
	select FLASH_PAGE_LAYOU
	select FILE_SYSTEM
	select FILE_SYSTEM_LITTLEFS
```

## modules/csk6_cm33/Kconfig
```kconfig
config CSK6_SDHC_CLK_FREQ
    int "sdhc clk frequency(Mhz) for csk6"
    default 25
    help
        "sdch clk frequency for csk6"

config CSK6_SDHC_SDMA_LINE_BOUND
    int "sdhc sdma line bound for csk6"
    default 4
    range 0 7
    help 
        sdhc sdma line bound for csk6
```

## modules/csk_heap/Kconfig
```kconfig
# Copyright (c) 2022 LISTENAI Corporation
# SPDX-License-Identifier: Apache-2.0

config CSK_HEAP
	bool "Use Private Memory Pool"
	depends on SOC_SERIES_CSK6
	default n
	help
	  Enable the use of private memory pool.

if CSK_HEAP

config CSK_HEAP_MEM_POOL_SIZE
	int "Private heap memory pool size (in bytes)"
	default 4096
	help
	  This option specifies the size of the heap memory pool used when
	  dynamically allocating memory using csk_malloc(). The maximum size of
	  the memory pool is only limited to available memory. A size of zero
	  means that no heap memory pool is defined.

config CSK_HEAP_MEM_POOL_SECTION_NAME
	string "Private heap memory pool section name"
	default ".psram_section" if (SOC_SERIES_CSK6 && CSK6_PSRAM)
	default ".bss"
	help
	  This option specifies the size of the heap memory pool used when
	  dynamically allocating memory using csk_malloc(). The maximum size of
	  the memory pool is only limited to available memory. A size of zero
	  means that no heap memory pool is defined.

endif # CSK_HEAP
```

## modules/esp_hosted_glue/Kconfig
```kconfig
# SPDX-License-Identifier: Apache-2.0

menuconfig ESP_HOSTED
	bool "ESP-Hosted support"
	select PROTOBUF_C

if ESP_HOSTED

module = ESP_HOSTED
module-str = esp-hosted
source "subsys/logging/Kconfig.template.log_config"

config HOSTED_INIT_TIMEOUT
	int "Hosted Init Timeout(s)"
	default 3

config HOSTED_TRANSACTION_STACK
	int "Hosted Transaction Thread Stack"
	default 2048

config HOSTED_TRANSACTION_PRIORITY
	int "Hosted Transaction Thread priority"
	default -1

config HOSTED_PROCESS_RX_STACK
	int "Hosted Processing Thread Stack"
	default 2048

config HOSTED_PROCESS_RX_PRIORITY
	int "Hosted Processing Thread priority"
	default -1

config HOSTED_TX_QUEUE_LEN
	int "Hosted TX Queue Len"
	default 30

config HOSTED_RX_QUEUE_LEN
	int "Hosted RX Queue Len"
	default 30

config HOSTED_SERIALIF_QUEUE_LEN
	int "Hosted Serial if queue len"
	default 50

config HOSTED_NETIF_QUEUE_LEN
	int "Hosted Net if queue len"
	default 50

config HOSTED_RAW_THROUGHPUT_TEST_ENABLE
	bool "Esp-Hosted Raw throughput testing enable"
	default false

if HOSTED_RAW_THROUGHPUT_TEST_ENABLE

config HOSTED_RAW_THROUGHPUT_TEST_ESP_TO_HOST
	bool "test ESP -> host raw throughput"
	default true
	help
	  if true, test ESP -> host raw throughput
	  else, test Host -> ESP raw throughput

config HOSTED_RAW_THROUGHPUT_TEST_HOST_TO_ESP_STACK
	int "Host to ESP raw throughput test thread stack"
	default 4096

config HOSTED_RAW_THROUGHPUT_TEST_HOST_TO_ESP_PRIORITY
	int "Host to ESP raw throughput test thread prority"
	default -1

endif # HOSTED_RAW_THROUGHPUT_TEST_ENABLE

endif # ESP_HOSTED
```

## modules/mbedtls/Kconfig
```kconfig
config CSK_MBEDTLS_HARDWARE_ALT
	bool "CSK6 MbedTLS Hardware Acceleration"
	depends on CRYPTO
	default n

config CSK_MBEDTLS_HARDWARE_AES
	bool "CSK6 MbedTLS Hardware AES"
	depends on CSK_MBEDTLS_HARDWARE_ALT
	default n
```

## samples/boards/csk6/driver/display/ili9488/sample.yaml
```yaml
sample:
  description: Sample application for displays ili9488
  name: display_sample
tests:
  sample.board.csk6.display.ili9488:
    platform_allow: csk6011a_nano
    tags: csk6
    harness: console
    timeout: 10
    harness_config:
      type: multi_line
      regex:
        - "init success"
```

## samples/boards/csk6/driver/display/refresh_rate/sample.yaml
```yaml
sample:
  description: Sample application for displays ili9488
  name: display_sample
tests:
  sample.board.csk6.display.refresh_rate:
    platform_allow: csk6011a_nano
    tags: csk6
    harness: console
    timeout: 10
    harness_config:
      fixture: display_st7789_ft5336
      type: multi_line
      regex:
        - "display frame:"
```

## samples/boards/csk6/driver/exmcu_gpio_led/sample.yaml
```yaml
sample:
  name: exmcu_gpio_led Sample

tests:
  sample.board.csk6.drivers.exmcu.gpio_led:
    harness: console
    harness_config:
      fixture: ch32v003
      type: one_line
      regex:
        - "GPIO LOOPBACK TEST OK"
```

## samples/boards/csk6/driver/exmcu_pwm/sample.yaml
```yaml
sample:
  name: gpio_led Sample
tests:
  sample.board.csk6.drivers.exmcu.pwm:
    platform_allow: csk6011a_nano csk6012_nano
    tags:
      - LED
      - gpio
    filter: dt_enabled_alias_with_parent_compat("led0", "gpio-leds")
    depends_on: gpio
    harness: led
```

## samples/boards/csk6/driver/i2c/i2c_slave_vdev/sample.yaml
```yaml
tests:
  sample.board.csk6.driver.i2c.i2c_slave_vdev:
    platform_allow: csk6011a_nano
    tags: csk6
    timeout: 10
    harness: console
    harness_config:
      type: one_line
      ordered: true
      regex:
        - "I2C Addr:"
```

## samples/boards/csk6/driver/i2c/master_slave/sample.yaml
```yaml
tests:
  sample.board.csk6.driver.i2c.master_slave:
    platform_allow: csk6002_9s_nano
    tags: csk6
```

## samples/boards/csk6/driver/rtc/pcf8563/sample.yaml
```yaml
tests:
  sample.board.csk6.driver.rtc.pcf8563:
    platform_allow: csk6011a_nano
    tags: csk6
    timeout: 10
    harness: console
    harness_config:
      fixture: rtc_pcf8563
      type: one_line
      ordered: true
      regex:
        - "RTC Time:"
```

## samples/boards/csk6/driver/uart/uart_interrupt/sample.yaml
```yaml
tests:
  sample.board.csk6.driver.uart.interrupt:
    platform_allow: csk6011a_nano
    timeout: 20
    tags: csk6
    harness: console
    harness_config:
      type: multi_line
      regex:
        - "devices uart@\\d+ is ready"
        - "devices uart@\\d+ is ready"
```

## samples/boards/csk6/driver/uart/uart_polling/sample.yaml
```yaml
tests:
  sample.board.csk6.driver.uart.polling:
    platform_allow: csk6011a_nano
    tags: csk6
    harness: console
    harness_config:
      type: one_line
      regex:
        - "devices uart@\\d+ is ready"
```

## samples/boards/csk6/driver/video/bf30a2/sample/sample.yaml
```yaml
tests:
  sample.board.csk6.driver.video.bf30a2:
    platform_allow: csk6011a_nano
    tags: csk6
    build_only: true
```

## samples/boards/csk6/subsys/display/lvgl/wedgets/sample.yaml
```yaml
sample:
  description: LVGL sample application
  name: lvgl
tests:
  sample.display.lvgl.gui.wedgets:
    build_only: true
    platform_allow: csk6011a_nano
```

## samples/boards/csk6/subsys/fault/sample.yaml
```yaml
sample:
  description: fault sample, the simplest Zephyr
    application
  name: fault
```

## samples/boards/csk6001/apps/lisa_porting/Kconfig
```kconfig
# SPDX-License-Identifier: Apache-2.0

menu "Example Configuration"

    config EXAMPLE_WIFI_SSID
        string "WiFi SSID"
        default "TP-LINK_BA83"
        #default "TP-LINK_LINGSI"

    config EXAMPLE_WIFI_PASSWORD
        string "WiFi password"
        default "ab123456"
        #default "a123456789"

endmenu

DT_CHOSEN_Z_LISA_HEAP := zephyr,lisa_heap

config LISA_HEAP_BASE_ADDRESS
	hex
	default "$(dt_chosen_reg_addr_hex,$(DT_CHOSEN_Z_LISA_HEAP))"
	help
	  This option specifies base address of the memory region to
	  be used for the lisa heap memory

config LISA_HEAP_SIZE
	hex
	default "$(dt_chosen_reg_size_hex,$(DT_CHOSEN_Z_LISA_HEAP))"
	help
	  This option specifies size of the memory region to be used
	  for the lisa heap memory



source "Kconfig.zephyr"
```
