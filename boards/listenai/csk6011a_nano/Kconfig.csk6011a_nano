## boards/listenai/csk6011a_nano/Kconfig.csk6011a_nano
```kconfig
# SPDX-License-Identifier: Apache-2.0

config BOARD_CSK6011A_NANO
   select SOC_CSK6011A
```

## soc/listenai/csk/Kconfig.defconfig
```kconfig
# Copyright (c) 2024 ListenAI
#
# SPDX-License-Identifier: Apache-2.0

if SOC_FAMILY_LISTENAI_CSK

rsource "*/Kconfig.defconfig.series"

endif # SOC_FAMILY_LISTENAI_CSK
```

## soc/listenai/csk/Kconfig.soc
```kconfig
# Copyright (c) 2024 Fujie Li <cexianl@gmail.com>
# SPDX-License-Identifier: Apache-2.0

config SOC_FAMILY_LISTENAI_CSK
	bool
	default y

config SOC_FAMILY
	default "listenai_csk" if SOC_FAMILY_LISTENAI_CSK

rsource "*/Kconfig.soc"
```

## soc/listenai/csk/csk6/Kconfig.defconfig.series
```kconfig
# Copyright (c) 2024 Fujie Li <cexianl@gmail.com>
# SPDX-License-Identifier: Apache-2.0

config SOC_CSK6
	bool "soc csk6"

config SOC_SERIES_CSK6
	select ARM
	select CPU_CORTEX_M33
	select CPU_CORTEX_M_HAS_DWT
	select CPU_HAS_FPU
	select CPU_HAS_MPU
	select CPU_HAS_ARM_MPU
	select ARMV8_M_DSP
	select CPU_CORTEX_M_HAS_SYSTICK
	select HAS_CSK6
	select CPU_HAS_CUSTOM_FIXED_SOC_MPU_REGIONS
	select ARCH_HAS_NOCACHE_MEMORY_SUPPORT
	select BUILD_OUTPUT_HEX
	select PLATFORM_SPECIFIC_INIT
	select PINCTRL
	select CPU_HAS_DCACHE
	select CPU_HAS_ICACHE
    select HAS_CSK6
	select SOC_CSK6

if SOC_SERIES_CSK6

DT_CHOSEN_Z_FLASH := zephyr,flash

config FLASH_SIZE
	default $(dt_chosen_reg_size_int,$(DT_CHOSEN_Z_FLASH),0,K)

config FLASH_BASE_ADDRESS
	default $(dt_chosen_reg_addr_hex,$(DT_CHOSEN_Z_FLASH))
	
config SYS_CLOCK_HW_CYCLES_PER_SEC
	default $(dt_node_int_prop_int,/cpus/cpu@0,clock-frequency)

config NUM_IRQS
	default 32

config HAS_CSK6
    bool

config CSK6_ICACHE
    bool "Enable CSK6 ICACHE"
    default y
    help
        Enable CSK6 ICACHE

config CSK6_DCACHE
    bool "Enable CSK6 DCACHE"
    default y
    help
        Enable CSK6 DCACHE

config CSK6_PSRAM
    bool "Enable CSK6 PSRAM"
    default y
    help
        Enable CSK6 PSRAM

rsource "Kconfig.defconfig.csk6*"

endif # SOC_SERIES_CSK6
```

## soc/listenai/csk/csk6/Kconfig.soc
```kconfig
# Copyright (c) 2024 ListenAI
# SPDX-License-Identifier: Apache-2.0

config SOC_SERIES_CSK6
	bool
	select SOC_FAMILY_LISTENAI_CSK
	help
	  Enable support for ListenAI CSK6 MCU series

config SOC_SERIES
	default "csk6" if SOC_SERIES_CSK6

config SOC_CSK6011A
	bool
	select SOC_SERIES_CSK6

config SOC_CSK6011B
	bool
	select SOC_SERIES_CSK6

config SOC_CSK6012
	bool
	select SOC_SERIES_CSK6

config SOC
	default "csk6011a" if SOC_CSK6011A
	default "csk6011b" if SOC_CSK6011B
	default "csk60112" if SOC_CSK6012
```

## soc/listenai/csk/csk6/common/Kconfig
```kconfig
config CSK6_FATAL
    bool "csk fatal"
    default y

config CSK6_FATAL_BACKTRACE
    bool "csk fatal backtrace"
    default y
    select EXTRA_EXCEPTION_INFO

config CSK6_FATAL_UNHANDLE_INTERRUPT
    bool "csk fatal unhandled interrupt"
    default y
```
