## sample.yaml
```
tests:
  sample.board.csk6001.network.wifi_sta:
    platform_allow: csk6001_tester
    tags: csk6001
```

## prj.conf
```kconfig
CONFIG_GPIO=y
CONFIG_SPI=y
CONFIG_WIFI=y
CONFIG_CSK_WIFI_STATION=y
CONFIG_ESP_HOSTED=y
CONFIG_NET_L2_ETHERNET=y

CONFIG_NEWLIB_LIBC=y

CONFIG_NETWORKING=y
CONFIG_NET_DHCPV4=y
CONFIG_NET_IPV4=y
CONFIG_NET_SOCKETS=y
CONFIG_NET_SOCKETS_POSIX_NAMES=y

CONFIG_NET_MGMT=y
CONFIG_NET_MGMT_EVENT=y
CONFIG_NET_MGMT_EVENT_STACK_SIZE=4096

CONFIG_NET_RX_STACK_SIZE=2048
CONFIG_NET_TX_STACK_SIZE=2048
CONFIG_NET_PKT_RX_COUNT=16
CONFIG_NET_PKT_TX_COUNT=16
CONFIG_NET_BUF_RX_COUNT=64
CONFIG_NET_BUF_TX_COUNT=64
CONFIG_NET_CONTEXT_NET_PKT_POOL=y

CONFIG_HEAP_MEM_POOL_SIZE=128000
CONFIG_MAIN_STACK_SIZE=4096
CONFIG_TEST_RANDOM_GENERATOR=y
CONFIG_INIT_STACKS=y

CONFIG_LOG=y
CONFIG_WIFI_LOG_LEVEL_DBG=y
```

## src/main.c
```c
/*
 * SPDX-License-Identifier: Apache-2.0
 */

#include <stdlib.h>
#include <sys/printk.h>
#include <sys/sys_heap.h>

#include <net/net_if.h>
#include <net/net_core.h>
#include <net/net_context.h>
#include <net/net_mgmt.h>

#include <logging/log.h>
LOG_MODULE_REGISTER(csk_wifi_sta, LOG_LEVEL_DBG);

#include "csk6001/csk_wifi.h"

static csk_wifi_event_cb_t wifi_event_cb;

static void wifi_event_handler(csk_wifi_event_t events, void *event_data, uint32_t data_len, void *arg)
{
    if (events & CSK_WIFI_EVT_SCAN_DONE) {
        printk("scan done\n");
    } else {
        abort();
    }
}

void main(void)
{
    csk_wifi_init();
    wifi_event_cb.handler = &wifi_event_handler;
    wifi_event_cb.events = CSK_WIFI_EVT_SCAN_DONE;
    wifi_event_cb.arg = NULL;
    csk_wifi_add_callback(&wifi_event_cb);

    csk_wifi_result_t result;

    while (1) {
        csk_wifi_scan_info_t *ap_list;
        int count = csk_wifi_scan_ap(&ap_list, &result, K_FOREVER);
        if (count < 0) {
            continue;
        }
        printk("-----------------------------------Scan AP list------------------------------------\n");
        for (int i = 0; i < count; i++) {
            printk("|ssid: %-20s | bssid: %-18s | channel: %-3d | rssi: %-3d|\n",
                    ap_list[i].ssid, ap_list[i].bssid, ap_list[i].channel, ap_list[i].rssi);
        }
        printk("-----------------------------------------------------------------------------------\n");
        k_free(ap_list);
        ap_list = NULL;
        k_msleep(1000);
    }
}
```
