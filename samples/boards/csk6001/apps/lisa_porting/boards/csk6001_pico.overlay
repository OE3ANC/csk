/*
 * Copyright (c) 2021 listenai Intelligent Technology (anhui) Co., Ltd.
 *
 * SPDX-License-Identifier: Apache-2.0
 */


 / {
	chosen {
		/*
		 * shared memory reserved for the inter-processor communication
		 */
		zephyr,lisa_heap = &psram_region1;
	};
	psram_region1:memory@30700000{
		compatible = "mmio-sram";
		reg = <0x30700000 0x1000000>;
	};


};

 
