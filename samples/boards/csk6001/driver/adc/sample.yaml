## samples/boards/csk6001/driver/dma_memcpy/sample.yaml
```yaml
tests:
  sample.board.csk6001.dma_memcpy:
    platform_allow: csk6002_c3_nano
    tags: csk6
```

## samples/boards/csk6001/driver/i2c/master_slave/sample.yaml
```yaml
tests:
  sample.board.csk6001.driver.i2c.master_slave:
    platform_allow: csk6001_tester
    tags: csk6001
```

## samples/boards/csk6001/driver/ipm_csk6001/sample.yaml
```yaml
tests:
  sample.board.csk6001.driver.ipm_csk6001:
    platform_allow: csk6002_c3_nano
    tags: csk6
```

## samples/boards/csk6001/driver/keysense/sample.yaml
```yaml
sample:
  name: keysense 

tests:
  sample.board.csk6001.driver.keysense:
    platform_allow: csk6002_c3_nano
    tags: csk6
```

## samples/boards/csk6001/driver/rtc/sample.yaml
```yaml
sample:
  name: rtc 

tests:
  sample.board.csk6001.driver.rtc:
    platform_allow: csk6002_c3_nano
    tags: csk6
```

## samples/boards/csk6001/driver/soc_flash_listenai/sample.yaml
```yaml
sample:
  name: SoC Flash on csk6001
tests:
  sample.board.csk6001.driver.soc_flash_listenai:
    platform_allow: csk6001_tester
    tags: flash csk6001
    harness: console
    harness_config:
      type: multi_line
      ordered: true
      regex:
        -  "Flash erase succeeded"
        -  "Data read: 1234"
        -  "Data read matches data written. Good!"
        -  "Flash erase succeeded"
        -  "Data read: 1122"
        -  "Data read matches data written. Good!"
        -  "Flash erase succeeded"
        -  "Data read: 1234"
        -  "Data read: 1234"
        -  "Data read matches data written. Good!"
        -  "SoC flash consists of \\d+ pages."
        -  "write-block-size = 1"
```

## samples/boards/csk6001/driver/spi_master/sample.yaml
```yaml
tests:
  sample.board.csk6001.spi_master:
    platform_allow: csk6001_tester
    tags: csk6001
```

## samples/boards/csk6001/driver/video/app/sample.yaml
```yaml
tests:
  sample.board.csk6001.driver.video.app:
    platform_allow: csk6002_c3_nano
    tags: csk6
```

## samples/boards/csk6001/driver/video/cp/sample.yaml
```yaml
sample:
  description: Video cp  sample, the simplest Zephyr
    application
  name: video cp 
common:
    tags: introduction
    integration_platforms:
      - native_posix
    harness: console
    harness_config:
      type: one_line
      regex:
        - "video cp ! (.*)"
```

## samples/boards/csk6001/driver/wdt/sample.yaml
```yaml
tests:
  sample.board.csk6001.wdt:
    platform_allow: csk6002_c3_nano
    tags: csk6001
```

## samples/boards/csk6001/network/wifi_mgr/sample.yaml
```yaml
tests:
  sample.board.csk6001.network.wifi_mgr:
    platform_allow: csk6002_c3_nano
    tags: csk6001
```

## samples/boards/csk6001/subsys/ipc/openamp_load_fw/sample.yaml
```yaml
tests:
  sample.board.csk6001.subsys.ipc.openamp_load_fw:
    platform_allow: csk6001_tester
    tags: csk6001
```

## samples/boards/csk6001/subsys/usb/cdc/console_shell/sample.yaml
```yaml
tests:
  sample.board.csk6001.subsys.usb.cdc.console_shell:
    platform_allow: csk6001_tester
    tags: csk6001
```

## samples/boards/csk6001/subsys/usb/dfu/sample.yaml
```yaml
sample:
  name: USB DFU sample
tests:
  sample.board.csk6001.subsys.usb.dfu:
    platform_allow: csk6002_c3_nano
    tags: csk6
```

## samples/driver/counter/sample.yaml
```yaml
sample:
  name: rtc
tests:
  csk.samples.driver.counter:
    platform_allow: csk6011a_nano csk6_duomotai_devkit
    tags: csk6
    build_only: true
```

## samples/driver/exmcu_gpio_led/sample.yaml
```yaml
sample:
  name: exmcu_gpio_led Sample
tests:
  csk.samples.driver.exmcu_gpio_led:
    platform_allow: csk6_duomotai_devkit
    tags: csk6
    build_only: true
```

## samples/driver/gpio/sample.yaml
```yaml
sample:
  name: gpio Sample
tests:
  csk.samples.driver.gpio:
    platform_allow: csk6_duomotai_devkit
    tags: csk6
    build_only: true
```

## samples/driver/key_interrupt/sample.yaml
```yaml
sample:
  name: key_interrupt sample
tests:
  csk.samples.driver.key_interrupt:
    platform_allow: csk6_duomotai_devkit
    tags: csk6
    build_only: true
```

## samples/driver/spi_master/sample.yaml
```yaml
sample:
  name: SPI master Sample
tests:
  csk.samples.driver.spi_master:
    platform_allow: csk6011a_nano csk6_duomotai_devkit
    tags: csk6
    build_only: true
```

## samples/driver/uart/uart_interrupt/sample.yaml
```yaml
sample:
  name: uart_interrupt Sample
tests:
  csk.samples.driver.uart.uart_interrupt:
    platform_allow: csk6011a_nano csk6_duomotai_devkit
    tags: csk6
    build_only: true
```

## samples/driver/uart/uart_polling/sample.yaml
```yaml
sample:
  name: uart_polling Sample
tests:
  csk.samples.driver.uart.uart_polling:
    platform_allow: csk6011a_nano csk6_duomotai_devkit
    tags: csk6
    build_only: true
```
