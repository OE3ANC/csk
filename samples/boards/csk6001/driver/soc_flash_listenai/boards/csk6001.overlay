/*
 * Copyright (c) 2021 LISTENAI Co., Ltd.
 *
 * SPDX-License-Identifier: Apache-2.0
 */

/ {

};

&flash0 {
	partitions {
		compatible = "fixed-partitions";
		#address-cells = <1>;
		#size-cells = <1>;

		storage_partition: partition@78000 {
			label = "storage";
			reg = <0x7f8000 0x00008000>;
		};
	};
};
