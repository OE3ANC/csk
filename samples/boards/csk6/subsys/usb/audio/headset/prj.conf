## sample.yaml
```
sample:
  name: USB audio headset sample
tests:
  sample.board.csk6.subsys.usb.audio.headset:
    depends_on: usb_device
    build_only: true
    tags: usb
    platform_allow:
      - csk6002_9s_nano
      - csk6011a_nano
      - csk6012_nano
    harness: console
    harness_config:
      type: multi_line
      ordered: true
      regex:
        - "Found USB Headset Device"
        - "USB enabled"
```

## prj.conf
```kconfig
CONFIG_STDOUT_CONSOLE=y

#USB related configs
CONFIG_USB_DEVICE_STACK=y
CONFIG_USB_DEVICE_PRODUCT="Zephyr USB audio sample"

#LOG subsystem related configs
CONFIG_LOG=y
CONFIG_LOG_BUFFER_SIZE=10240
CONFIG_USB_DRIVER_LOG_LEVEL_ERR=y
CONFIG_USB_DEVICE_LOG_LEVEL_ERR=y

#net buf options
CONFIG_NET_BUF=y
# CONFIG_NET_BUF_USER_DATA_SIZE=0

#USB audio related configs
CONFIG_USB_DEVICE_AUDIO=y

CONFIG_USB_DEVICE_VID=0x3420
CONFIG_USB_DEVICE_PID=0x0108
CONFIG_USB_DEVICE_MANUFACTURER="ListenAi"
CONFIG_USB_DEVICE_PRODUCT="ListenAi USB audio sample"
CONFIG_USB_DEVICE_SN="0123456789ABCDB0"

# CONFIG_USB_AUDIO_LOG_LEVEL_DBG=y
```

## src/main.c
```c
/*
 * Copyright (c) 2020 Nordic Semiconductor ASA
 *
 * SPDX-License-Identifier: Apache-2.0
 */

/**
 * @file
 * @brief Sample app for Audio class
 */

#include <zephyr/kernel.h>
#include <zephyr/logging/log.h>
#include <zephyr/usb/usb_device.h>
#include <zephyr/usb/class/usb_audio.h>

LOG_MODULE_REGISTER(main, LOG_LEVEL_INF);

static void data_received(const struct device *dev,
			  struct net_buf *buffer,
			  size_t size)
{
	int ret;

	if (!buffer || !size) {
		/* This should never happen */
		return;
	}

	LOG_DBG("Received %d data, buffer %p", size, buffer);

	/* Check if the device OUT buffer can be used for input */
	if (size == usb_audio_get_in_frame_size(dev)) {
		ret = usb_audio_send(dev, buffer, size);
		net_buf_unref(buffer);
	} else {
		LOG_INF("size %d is wrong,  net buf unref", size);
		net_buf_unref(buffer);
	}
}

static void feature_update(const struct device *dev,
			   const struct usb_audio_fu_evt *evt)
{
	LOG_DBG("Control selector %d for channel %d updated",
		evt->cs, evt->channel);
	switch (evt->cs) {
	case USB_AUDIO_FU_MUTE_CONTROL:
		break;
	case USB_AUDIO_FU_VOLUME_CONTROL:
		LOG_INF("[%s] volume: %d, val_len: %d", __FUNCTION__, *((int16_t *)(evt->val)), evt->val_len);
		break;
	default:
		break;
	}
}

static const struct usb_audio_ops ops = {
	.data_received_cb = data_received,
	.feature_update_cb = feature_update,
};

void main(void)
{
	const struct device *hs_dev;
	int ret;

	LOG_INF("Entered %s", __func__);
	hs_dev = DEVICE_DT_GET_ONE(usb_audio_hs);

	if (!hs_dev) {
		LOG_ERR("Device USB Headset is not ready");
		return;
	}

	LOG_INF("Found USB Headset Device");

	usb_audio_register(hs_dev, &ops);

	ret = usb_enable(NULL);
	if (ret != 0) {
		LOG_ERR("Failed to enable USB");
		return;
	}

	LOG_INF("USB enabled");
}
```
