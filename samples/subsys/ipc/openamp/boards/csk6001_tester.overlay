/*
 * Copyright (c) 2021 ListenAI
 *
 * SPDX-License-Identifier: Apache-2.0
 */

/ {
	chosen {
		/*
		 * shared memory reserved for the inter-processor communication
		 */
		zephyr,ipc_shm = &sramx1;
		zephyr,ipc = &mailbox0;
	};

	sramx1:memory@CB000{
		compatible = "mmio-sram";
		reg = <0x000CB000 0x5000>;
	};
	
};
