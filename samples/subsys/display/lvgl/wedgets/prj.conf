## prj.conf
```kconfig
CONFIG_LV_Z_MEM_POOL_NUMBER_BLOCKS=8
CONFIG_MAIN_STACK_SIZE=20480

CONFIG_DISPLAY=y
CONFIG_DISPLAY_LOG_LEVEL_ERR=y

CONFIG_LOG=y

CONFIG_LVGL=y
CONFIG_LV_MEM_CUSTOM=y
CONFIG_LV_USE_LOG=y
CONFIG_LV_USE_LABEL=y
CONFIG_LV_USE_BTN=y
CONFIG_LV_USE_IMG=y
CONFIG_LV_FONT_MONTSERRAT_14=y


CONFIG_HEAP_MEM_POOL_SIZE=16384
CONFIG_LOG=y

CONFIG_GPIO=y

CONFIG_DISPLAY=y
CONFIG_SPI=y

CONFIG_KSCAN=y
CONFIG_I2C=y
CONFIG_KSCAN_FT5336=y
CONFIG_KSCAN_FT5336_INTERRUPT=y

# 触摸驱动
CONFIG_LV_Z_POINTER_KSCAN=y
CONFIG_LV_Z_POINTER_KSCAN_DEV_NAME="FT5336"
CONFIG_LV_Z_POINTER_KSCAN_SWAP_XY=n
CONFIG_LV_Z_POINTER_KSCAN_INVERT_Y=y
CONFIG_LV_Z_POINTER_KSCAN_INVERT_X=n

# 改配置为专为CSK6优化后的ST7789V驱动
CONFIG_ST7789V_CSK6=y

# ST7789V默认被打开了，需要手动关闭
CONFIG_ST7789V=n

# zephyr原有的驱动也是可以用的，只是帧率没有优化后的高






# CONFIG_ST7789V=y
# 在驱动层可支持90度旋转
CONFIG_ST7789V_CSK6_ROTATE_90=y

# 使用优化后的驱动后，配置此宏可以使用专为优化驱动的LVGL适配层
CONFIG_LV_Z_DRIVER_CSK6_16BIT=y

# 如需要旋转90度的话，zephyr适配层也要配置该宏
# 因ST7789V的IC从GRAM中读取数据的方向不能改变，
# 如果使用驱动IC的方向旋转的话，可能出现斜方向的撕裂
# 但如果在驱动层使用90°旋转的话，则只会存在Y方向的撕裂，
# Y方向的撕裂可以通过加TE引脚来解决
CONFIG_LV_Z_DRIVER_CSK6_16BIT_ROTATE_90=y

CONFIG_LV_Z_DRIVER_CSK6_KSAN_FILTER_TIME_MS=50

# 双缓冲区会提高帧率，占会大量占用内存
# 在开启双缓冲区的情况下，确保LVGL线程不是协程，
# 且COFNIG_LV_Z_DRIVER_SPD2010_THREAD_PRIORITY的优先级必须要高于LVGL线程
# 否则将会发生死锁
# 
CONFIG_LV_Z_DOUBLE_VDB=y
CONFIG_LV_Z_DRIVER_CSK6_16BIT_THREAD_PRIORITY=1
CONFIG_MAIN_THREAD_PRIORITY=2

CONFIG_LV_Z_VDB_SIZE=100

### 专为CSK6优化的LVGL适配层，可以自定义heap

# LVGL-ZEPHYR接口 自定义heap段
CONFIG_LV_Z_MEM_CUSTOM_SECTION=y
CONFIG_LV_Z_MEM_CUSTOM_SECTION_NAME=".psram_section"

# 自定义内存的大小配置，包含所有的LVGL对象  
CONFIG_LV_Z_MEM_POOL_MAX_SIZE=1024
CONFIG_LV_Z_MEM_POOL_NUMBER_BLOCKS=500

# 使用PSRAM的话，必须打开这个宏，这样所有的LVGL对象都从自定义段中分配内存  
CONFIG_LV_MEM_CUSTOM=y

## LVGL显存内存池配置，使用PSRAM的话 必须打开这个宏
CONFIG_LV_Z_BUFFER_ALLOC_DYNAMIC=y

CONFIG_LV_FONT_MONTSERRAT_18=y
CONFIG_LV_FONT_MONTSERRAT_12=y
CONFIG_LV_USE_DEMO_BENCHMARK=y
CONFIG_LV_USE_DEMO_WIDGETS=y
CONFIG_LV_COLOR_DEPTH_16=y
CONFIG_LV_COLOR_16_SWAP=n

CONFIG_LV_USE_PERF_MONITOR=y
CONFIG_LV_PERF_MONITOR_ALIGN_BOTTOM_RIGHT=y
```

## src/main.c
```c
/*
 * Copyright (c) 2018 Jan Van Winkel <jan.van_winkel@dxplore.eu>
 *
 * SPDX-License-Identifier: Apache-2.0
 */

#include <zephyr/device.h>
#include <zephyr/drivers/display.h>
#include <lvgl.h>
#include <stdio.h>
#include <string.h>
#include <zephyr/kernel.h>

#define LOG_LEVEL CONFIG_LOG_DEFAULT_LEVEL
#include <zephyr/logging/log.h>
LOG_MODULE_REGISTER(app);

int main(void)
{
	const struct device *display_dev;

	display_dev = DEVICE_DT_GET(DT_CHOSEN(zephyr_display));
	if (!device_is_ready(display_dev)) {
		LOG_ERR("Device not ready, aborting test");
		return 0;
	}

	display_blanking_off(display_dev);
	extern void lv_demo_benchmark(void);
	extern void lv_demo_widgets(void);

	lv_demo_widgets();
	// lv_demo_benchmark();

	lv_task_handler();

	while (1) {
		lv_task_handler();
		k_sleep(K_MSEC(30));
	}
	return 0;
}
```
