## CMakeLists.txt
```
# SPDX-License-Identifier: Apache-2.0

cmake_minimum_required(VERSION 3.20.0)

set(SUPPORT_BOARDS csk6012_nano csk6011a_nano csk6_duomotai_devkit)
if(NOT ${BOARD} IN_LIST SUPPORT_BOARDS)
    message("Please choose one of the following boards:")
    foreach(item ${SUPPORT_BOARDS})
        message(STATUS ${item})
    endforeach()
    message(FATAL_ERROR "\nThe project does not support the ${BOARD}")
endif()

find_package(Zephyr REQUIRED HINTS $ENV{ZEPHYR_BASE})
project(i2c_master)
target_sources(app PRIVATE src/main.c)
```

## sample.yaml
```
tests:
  sample.board.csk6.driver.i2c.i2c_master:
    platform_allow: csk6_duomotai_devkit
    build_only: true
    tags: csk6
```

## prj.conf
```kconfig
CONFIG_LOG=y
CONFIG_BOOT_BANNER=y

CONFIG_STDOUT_CONSOLE=y
CONFIG_PRINTK=y

CONFIG_SHELL=y
CONFIG_SHELL_LOG_LEVEL_INF=y

CONFIG_I2C=y
CONFIG_I2C_LOG_LEVEL_INF=y
```

## boards/csk6_duomotai_devkit.overlay
```dts
/*
 * Copyright (c) 2023 Anhui(Shenzhen) Listenai Co., Ltd.
 *
 * SPDX-License-Identifier: Apache-2.0
 */
 &pinctrl {
	/* I2C alternate function */
	pinctrl_i2c1_scl_default: i2c1_scl_default{
		pinctrls = <I2C1_SCL_GPIOB_09>;
	};

	pinctrl_i2c1_sda_default: i2c1_sda_default{
		pinctrls = <I2C1_SDA_GPIOB_08>;
	};
};

&i2c1 {
	status = "okay";
	pinctrl-0 = <&pinctrl_i2c1_scl_default &pinctrl_i2c1_sda_default>;
	pinctrl-names = "default";
};
```

## src/main.c
```c
/*
 * Copyright (c) 2023 Anhui(Shenzhen) Listenai Co., Ltd.
 *
 * SPDX-License-Identifier: Apache-2.0
 */
#include <zephyr/kernel.h>
#include <zephyr/device.h>
#include <zephyr/drivers/i2c.h>

#define I2C_DEV_LABEL 		"i2c_1" 	// 根据你的设备树修改
#define TARGET_DEVICE_ADDR 	0x38      	// I2C 从设备地址
#define TARGET_REG_ADDR 	0x96      	// I2C 从设备寄存器地址

int main(void)
{
    const struct device *i2c_dev;
	uint8_t i2c_reg_data_raw;
	uint8_t i2c_reg_data_modify;
    uint8_t data = 0x88; 

    int ret;

	i2c_dev = device_get_binding(I2C_DEV_LABEL);
    if (!i2c_dev) {
        printk("No I2C device found");
        return -1;
    }
    ret = i2c_configure(i2c_dev, I2C_SPEED_SET(I2C_SPEED_STANDARD) | I2C_MODE_CONTROLLER);
    if (ret < 0) {
        printk("i2c config failed\n");
        return -1;
    }
	
	ret = i2c_reg_read_byte(i2c_dev,TARGET_DEVICE_ADDR,TARGET_REG_ADDR,&i2c_reg_data_raw);
	if(ret < 0){
		printk("i2c_reg_read_byte failed!\n");
	}
	printk("i2c_reg_data_raw: %d\n",i2c_reg_data_raw);
	

	ret = i2c_reg_write_byte(i2c_dev,TARGET_DEVICE_ADDR,TARGET_REG_ADDR,data);
	if(ret < 0){
		printk("i2c_reg_write_byte failed!\n");
	}
	ret = i2c_reg_read_byte(i2c_dev,TARGET_DEVICE_ADDR,TARGET_REG_ADDR,&i2c_reg_data_modify);
	if(ret < 0){
		printk("i2c_reg_read_byte failed!\n");
	}
	printk("i2c_reg_data_modify: %d\n",i2c_reg_data_modify);
	
	return 0;
}
```
