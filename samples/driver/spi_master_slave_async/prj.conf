## CMakeLists.txt
```
# SPDX-License-Identifier: Apache-2.0

cmake_minimum_required(VERSION 3.20.0)

set(SUPPORT_BOARDS csk6012_nano csk6011a_nano)
if(NOT ${BOARD} IN_LIST SUPPORT_BOARDS)
    message("Please choose one of the following boards:")
    foreach(item ${SUPPORT_BOARDS})
        message(STATUS ${item})
    endforeach()
    message(FATAL_ERROR "\nThe project does not support the ${BOARD}")
endif()

find_package(Zephyr REQUIRED HINTS $ENV{ZEPHYR_BASE})
project(spi_master)

target_sources(app PRIVATE src/main.c src/spi_master.c src/spi_slave.c)
```

## sample.yaml
```
tests:
  sample.board.csk6.driver.spi_master_slave:
    platform_allow: csk6011a_nano
    tags: csk6
    harness: console
    harness_config:
      type: one_line
      ordered: true
      regex:
        - "SPI thread created"
```

## prj.conf
```kconfig
CONFIG_GPIO=y
CONFIG_SPI=y
CONFIG_SPI_ASYNC=y
CONFIG_LOG=y
CONFIG_HEAP_MEM_POOL_SIZE=10240
CONFIG_SPI_COMPLETION_TIMEOUT_TOLERANCE=10000
```

## src/main.c
```c
/*
 * Copyright (c) 2023 Anhui(Shenzhen) Listenai Co., Ltd.
 *
 * SPDX-License-Identifier: Apache-2.0
 */

#include <zephyr/kernel.h>
#include <errno.h>
#include <zephyr/kernel.h>
#include <zephyr/sys/printk.h>
#include <zephyr/device.h>
#include <zephyr/drivers/spi.h>
#include <string.h>

extern int spi_master_init(void);
extern int spi_slave_init(void);

void main(void)
{
	spi_master_init();
	spi_slave_init();
}
```

## src/spi_master.c
```c
/*
 * Copyright (c) 2023 Anhui(Shenzhen) Listenai Co., Ltd.
 *
 * SPDX-License-Identifier: Apache-2.0
 */

#include <zephyr/kernel.h>
#include <errno.h>
#include <zephyr/kernel.h>
#include <zephyr/sys/printk.h>
#include <zephyr/device.h>
#include <zephyr/drivers/spi.h>
#include <string.h>

#define BUF_SIZE 9


uint8_t *master_buffer_tx = NULL;
uint8_t *master_buffer_rx = NULL;


#define MASTER_STACK_SIZE 4096

K_THREAD_STACK_DEFINE(master_stack_area, MASTER_STACK_SIZE);


struct k_thread master_thread_data;

const struct device *spi_master = NULL;

int spi_master_dev_init(void)
{
	spi_master = DEVICE_DT_GET(DT_NODELABEL(spi0));
	if (spi_master == NULL) {
		printk("spi_master: Device is not found.\n");
		return -ENODEV;
	}

	if (!device_is_ready(spi_master)) {
		printk("spi_master: Device is not ready.\n");
		return -ENODEV;
	}
    master_buffer_tx = k_aligned_alloc(32,BUF_SIZE);
    for(int i=0;i<BUF_SIZE;i++){
        master_buffer_tx[i] = i;
    }

    master_buffer_rx = k_aligned_alloc(32,BUF_SIZE);
	return 0;
}


void master_thread(void *v1, void *v2, void *v3)
{
	struct spi_config spi_cfg = { 0 };


	const struct spi_buf tx_bufs[] = {
		{
			.buf = master_buffer_tx,
			.len = BUF_SIZE,
		},
	};
	const struct spi_buf rx_bufs[] = {
		{
			.buf = master_buffer_rx,
			.len = BUF_SIZE,
		},
	};
	const struct spi_buf_set tx = { .buffers = tx_bufs, .count = ARRAY_SIZE(tx_bufs) };
	const struct spi_buf_set rx = { .buffers = rx_bufs, .count = ARRAY_SIZE(rx_bufs) };

	/* spi master 8bit, LSB first*/
	spi_cfg.operation = SPI_WORD_SET(8) | SPI_OP_MODE_MASTER | SPI_TRANSFER_LSB;
	spi_cfg.frequency = 10 * 1000000UL;
    printk("[Master][%s %d]\n", __FUNCTION__, __LINE__);
	while (1) {
		k_msleep(1000);
		memset(master_buffer_rx, 0, BUF_SIZE);
        printk("[Master][%s %d]\n", __FUNCTION__, __LINE__);
		spi_transceive(spi_master, &spi_cfg, &tx, &rx);
		printk("[Master]receive:");
		for (uint8_t i = 0; i < BUF_SIZE; i++) {
			printk("0x%02x ", master_buffer_rx[i]);
		}
		printk("\n");
	}
}


void spi_master_init(void)
{
	int ret = 0;

	printk("SPI test start \n");

	ret = spi_master_dev_init();
	if(ret != 0){
		return;
	}

	/* create master thread */
	int pri = k_thread_priority_get(k_current_get());

	k_thread_create(&master_thread_data, master_stack_area,
			K_THREAD_STACK_SIZEOF(master_stack_area), master_thread, NULL, NULL, NULL,
			pri, 0, K_NO_WAIT);

	printk("SPI master thread created\n");

}
```

## src/spi_slave.c
```c
/*
 * Copyright (c) 2023 Anhui(Shenzhen) Listenai Co., Ltd.
 *
 * SPDX-License-Identifier: Apache-2.0
 */

#include <zephyr/kernel.h>
#include <errno.h>
#include <zephyr/kernel.h>
#include <zephyr/sys/printk.h>
#include <zephyr/device.h>
#include <zephyr/drivers/spi.h>
#include <string.h>

#define BUF_SIZE 9

uint8_t *slave_buffer_tx = NULL;
uint8_t *slave_buffer_rx = NULL;



#define SLAVE_STACK_SIZE 4096

K_THREAD_STACK_DEFINE(slave_stack_area, SLAVE_STACK_SIZE);

struct k_thread slave_thread_data;
const struct device *spi_slave = NULL;

static struct k_poll_signal async_sig = K_POLL_SIGNAL_INITIALIZER(async_sig);
static struct k_poll_event async_evt =
	K_POLL_EVENT_INITIALIZER(K_POLL_TYPE_SIGNAL,
				 K_POLL_MODE_NOTIFY_ONLY,
				 &async_sig);
static K_SEM_DEFINE(caller_sem, 0, 1);


int spi_slave_dev_init(void)
{
	spi_slave = DEVICE_DT_GET(DT_NODELABEL(spi1));
	if (spi_slave == NULL) {
		printk("spi_slave: Device is not found.\n");
		return -ENODEV;
	}

	if (!device_is_ready(spi_slave)) {
		printk("spi_slave: Device is not ready.\n");
		return -ENODEV;
	}
    slave_buffer_tx = k_aligned_alloc(32,BUF_SIZE);
    for(int i=0;i<BUF_SIZE;i++){
        slave_buffer_tx[i] = i;
    }

    slave_buffer_rx = k_aligned_alloc(32,BUF_SIZE);
	return 0;
}

static void spi_async_call_cb(void* ptr1,void *ptr2,void *ptr3)
{
	int ret;

	printk("Polling...");

	while (1) {
		ret = k_poll(&async_evt, 1, K_FOREVER);
        if(ret){
            printk("one or more events are not ready,ret:%d\n",ret);
            continue;
        }

        printk("Got data");

	
		k_sem_give(&caller_sem);

		/* Reinitializing for next call */
		async_evt.signal->signaled = 0U;
		async_evt.state = K_POLL_STATE_NOT_READY;
	}
}


void slave_thread(void *v1, void *v2, void *v3)
{
	struct spi_config spi_cfg = { 0 };

	const struct spi_buf tx_bufs[] = {
		{
			.buf = slave_buffer_tx,
			.len = BUF_SIZE,
		},
	};
	const struct spi_buf rx_bufs[] = {
		{
			.buf = slave_buffer_rx,
			.len = BUF_SIZE,
		},
	};
	const struct spi_buf_set tx = { .buffers = tx_bufs, .count = ARRAY_SIZE(tx_bufs) };
	const struct spi_buf_set rx = { .buffers = rx_bufs, .count = ARRAY_SIZE(rx_bufs) };

	/* spi slave 8bit, LSB first*/
	spi_cfg.operation = SPI_WORD_SET(8) | SPI_OP_MODE_SLAVE | SPI_TRANSFER_LSB;
	spi_cfg.frequency = 10 * 1000000UL;

	while (1) {
		memset(slave_buffer_rx, 0, BUF_SIZE);
		// spi_transceive(spi_slave, &spi_cfg, &tx, &rx);
		spi_transceive_signal(spi_slave,&spi_cfg, &tx, &rx, &async_sig);

        k_sem_take(&caller_sem, K_FOREVER);

		printk("[Slave]receive:");
		for (uint8_t i = 0; i < BUF_SIZE; i++) {
			printk("0x%02x ", slave_buffer_rx[i]);
		}
		printk("\n");
	}
}


void spi_slave_init(void)
{
	int ret = 0;

	printk("SPI test start \n");
	ret = spi_slave_dev_init();
	if(ret != 0){
		return;
	}

	/* create slave thread */
	int pri = k_thread_priority_get(k_current_get());

	k_thread_create(&slave_thread_data, slave_stack_area,
			K_THREAD_STACK_SIZEOF(slave_stack_area), slave_thread, NULL, NULL, NULL,
			pri, 0, K_NO_WAIT);
	printk("SPI slave thread created\n");

	while (1) {
		k_msleep(10);
	}
}

K_THREAD_DEFINE(spi_async_thread_id, 4096, spi_async_call_cb, NULL, NULL, NULL, 2, 0, 1000);
```
