## CMakeLists.txt
```
# SPDX-License-Identifier: Apache-2.0

cmake_minimum_required(VERSION 3.20.0)

set(SUPPORT_BOARDS csk6_duomotai_devkit)
if(NOT ${BOARD} IN_LIST SUPPORT_BOARDS)
    message("Please choose one of the following boards:")
    foreach(item ${SUPPORT_BOARDS})
        message(STATUS ${item})
    endforeach()
    message(FATAL_ERROR "\nThe project does not support the ${BOARD}")
endif()

find_package(Zephyr REQUIRED HINTS $ENV{ZEPHYR_BASE})
project(exmcu_pwm)

target_sources(app PRIVATE src/main.c)
```

## sample.yaml
```
sample:
  name: EXMCU PWM sample
tests:
  csk.samples.driver.exmcu_pwm:
    platform_allow: csk6_duomotai_devkit
    tags: csk6
    build_only: true
```

## prj.conf
```kconfig
CONFIG_PWM=y
CONFIG_PWM_CSK6_CH32V003=y
CONFIG_I2C=y
CONFIG_PWM_CSK6=n
```

## app.overlay
```dts
/ {
    motor {
        motor_pwm: motor_pwm {
            compatible = "vnd,phandle-holder";
            status = "okay";
            pwms = <&expwm 0 1000 0x0 100>;
        };
    };

    aliases {
        csk6-exmcu = &csk6_ch32v003;
    };
};
```

## boards/csk6_duomotai_devkit.overlay
```dts
/*
 * Copyright (c) 2023 Anhui(Shenzhen) Listenai Co., Ltd.
 *
 * SPDX-License-Identifier: Apache-2.0
 */
 

&expwm{
        clock-prescaler = <4800>;
        clock-frequency = <48000000>;
};

/ {
    motor {
        motor_pwm: motor_pwm {
            compatible = "vnd,phandle-holder";
            status = "okay";
            pwms = <&expwm 0 1000 0x0 100>;
        };
    };

};
```

## src/main.c
```c
/*
 * Copyright (c) 2023 Anhui(Shenzhen) Listenai Co., Ltd.
 *
 * SPDX-License-Identifier: Apache-2.0
 */

#include <zephyr/device.h>
#include <zephyr/devicetree.h>
#include <zephyr/drivers/gpio.h>
#include <zephyr/drivers/pwm.h>
#include <zephyr/kernel.h>

const struct pwm_dt_spec spec = PWM_DT_SPEC_GET(DT_NODELABEL(motor_pwm));

int _pwm_set(uint32_t period_ms,
			     uint32_t pulse_ms)
{
	int err;
	uint64_t pulse_cycles;
	uint64_t period_cycles;
	uint64_t cycles_per_sec;

	err = pwm_get_cycles_per_sec(spec.dev, spec.channel, &cycles_per_sec);
	if (err < 0) {
		return err;
	}

	period_cycles = (period_ms * cycles_per_sec) / MSEC_PER_SEC;
	if (period_cycles > UINT16_MAX) {
		return -ENOTSUP;
	}

	pulse_cycles = (pulse_ms * cycles_per_sec) / MSEC_PER_SEC;
	if (pulse_cycles > UINT16_MAX) {
		return -ENOTSUP;
	}

	return pwm_set_cycles(spec.dev, spec.channel, (uint32_t)period_cycles,
			      (uint32_t)pulse_cycles, spec.flags);
}

int main(void)
{
	int r = 0;

	if (!device_is_ready(spec.dev)) {
		printk("device: %s is not ready\n", spec.dev->name);
		return 0;
	}

	printk("name: %s \n", spec.dev->name);
	printk("channel: %d \n", spec.channel);
	printk("period: %d \n", spec.period);
	printk("flag: %d \n", spec.flags);

	r = _pwm_set(spec.period, spec.period / 2);
	if (r) {
		printk("pwm set failed, r:%d\n", r);
		return 0;
	}

	return 0;
}
```
