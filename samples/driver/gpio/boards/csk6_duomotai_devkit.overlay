/*
 * Copyright (c) 2023 Anhui(Shenzhen) Listenai Co., Ltd.
 *
 * SPDX-License-Identifier: Apache-2.0
 */

/{
    aliases {
        gpioa7 = &gpioa7;
    };

    gpio,user {
        compatible = "listenai,csk-gpio-user";
        gpioa7: gpioa7 {
            gpios = <&gpioa 0x7 0x0>;
            label = "gpioa_7";
        };
    };
};
