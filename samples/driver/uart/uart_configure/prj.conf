## CMakeLists.txt
```
# SPDX-License-Identifier: Apache-2.0

cmake_minimum_required(VERSION 3.20.0)

set(SUPPORT_BOARDS csk6012_nano csk6011a_nano csk6012_c3_nano csk6011a_c3_nano csk6_duomotai_devkit)
if(NOT ${BOARD} IN_LIST SUPPORT_BOARDS)
    message("Please choose one of the following boards:")
    foreach(item ${SUPPORT_BOARDS})
        message(STATUS ${item})
    endforeach()
    message(FATAL_ERROR "\nThe project does not support the ${BOARD}")
endif()

find_package(Zephyr REQUIRED HINTS $ENV{ZEPHYR_BASE})
project(uart)

target_sources(app PRIVATE src/main.c)
```

## sample.yaml
```
tests:
  sample.board.csk6.driver.uart.configure:
    platform_allow: csk6011a_nano csk6_duomotai_devkit
    tags: csk6
    harness: console
    harness_config:
      type: multi_line
      regex:
        - "config result:"
        - "baudrate: 115200"
        - "data_bits: 3"
        - "stop_bits: 1"
        - "flow_ctrl: 0"
        - "parity: 0"
        - "hello world"
```

## prj.conf
```kconfig
CONFIG_UART_CSK6=y
CONFIG_PRINTK=y
CONFIG_UART_USE_RUNTIME_CONFIGURE=y
```

## app.overlay
```dts
&uart0 {
    current-speed = <9600>;
};
```

## src/main.c
```c
/*
 * Copyright (c) 2012-2014 Wind River Systems, Inc.
 *
 * SPDX-License-Identifier: Apache-2.0
 */
#include <string.h>

#include <zephyr/devicetree.h>
#include <zephyr/drivers/uart.h>
#include <zephyr/kernel.h>
#include <zephyr/sys/printk.h>
#include <zephyr/kernel.h>

#define DELAY_TIME_SEC 6
#define NEW_BAUDRATE   115200

void print_uart_config(const struct uart_config *cfg)
{
	printk("baudrate: %d\n", cfg->baudrate);
	printk("data_bits: %d\n", cfg->data_bits);
	printk("stop_bits: %d\n", cfg->stop_bits);
	printk("flow_ctrl: %d\n", cfg->flow_ctrl);
	printk("parity: %d\n", cfg->parity);
}

int main(void)
{
	const struct device *dev = DEVICE_DT_GET(DT_CHOSEN(zephyr_console));
	struct uart_config cfg = {0};

	if (!device_is_ready(dev)) {
		printk("device:%s is not ready!\n", dev->name);
		return -1;
	}

	if (uart_config_get(dev, &cfg) != 0) {
		printk("uart config get failed.\n");
		return -1;
	}

	if (cfg.baudrate == NEW_BAUDRATE) {
		printk("current baudrate is same as new baudrate(%d).\n", NEW_BAUDRATE);
		return -1;
	}

	printk("current uart configuration:\n");
	print_uart_config(&cfg);

	int c = DELAY_TIME_SEC;
	while (c) {
		printk("baudrate will change to %d after %d sec.\n", NEW_BAUDRATE, c--);
		k_msleep(1000);
	}

	cfg.baudrate = NEW_BAUDRATE;

	if (uart_configure(dev, &cfg) != 0) {
		printk("uart configure failed.\n");
		return -1;
	}

	printk("uart configuration succeeded.\n");

	if (uart_config_get(dev, &cfg) != 0) {
		printk("uart config get failed.\n");
		return -1;
	}
	printk("config result:\n");
	print_uart_config(&cfg);

	while (1) {
		printk("hello world\n");
		k_msleep(500);
	}

	return 0;
}
```
