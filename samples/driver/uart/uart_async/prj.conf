## CMakeLists.txt
```
# SPDX-License-Identifier: Apache-2.0

cmake_minimum_required(VERSION 3.20.0)

set(SUPPORT_BOARDS csk6012_nano csk6011a_nano csk6012_c3_nano csk6011a_c3_nano csk6_duomotai_devkit)
if(NOT ${BOARD} IN_LIST SUPPORT_BOARDS)
    message("Please choose one of the following boards:")
    foreach(item ${SUPPORT_BOARDS})
        message(STATUS ${item})
    endforeach()
    message(FATAL_ERROR "\nThe project does not support the ${BOARD}")
endif()

find_package(Zephyr REQUIRED HINTS $ENV{ZEPHYR_BASE})
project(uart)

target_sources(app PRIVATE src/main.c)
```

## sample.yaml
```
tests:
  sample.board.csk6.driver.uart.uart_async:
    platform_allow: csk6011a_nano csk6_duomotai_devkit
    build_only: true
    tags: csk6
    harness: console
    harness_config:
      fixture: gpio_loopback
      type: multi_line
      regex:
        - "Uart async tx-rx sample"
        - "Uart async tx-rx complete"
```

## prj.conf
```kconfig
CONFIG_UART_ASYNC_API=y
CONFIG_LOG=y
CONFIG_DMA=y
CONFIG_DMA_CSK6=y
CONFIG_NOCACHE_MEMORY=y
```

## src/main.c
```c
/*
 * Copyright (c) 2023 Anhui(Shenzhen) Listenai Co., Ltd.
 *
 * SPDX-License-Identifier: Apache-2.0
 */
#include <string.h>

#include <zephyr/devicetree.h>
#include <zephyr/drivers/uart.h>
#include <zephyr/kernel.h>
#include <zephyr/logging/log.h>
#include <zephyr/sys/printk.h>
#include <zephyr/kernel.h>

LOG_MODULE_REGISTER(sample, LOG_LEVEL_INF);

K_SEM_DEFINE(tx_done, 0, 1);
K_SEM_DEFINE(rx_rdy, 0, 1);

static void uart_async_callback(const struct device *dev, struct uart_event *evt, void *user_data)
{
	ARG_UNUSED(dev);

	const uint8_t *events_name[] = {
		"tx done",	  "tx abort",	     "rx ready",
		"rx buf request", "rx buf released", "rx disabled",
	};

	printk("evt type: %d, event name:%s\n", evt->type, events_name[evt->type]);

	switch (evt->type) {
	case UART_TX_DONE:
		k_sem_give(&tx_done);
		break;
	case UART_RX_RDY:
		k_sem_give(&rx_rdy);
		break;
	default:
		break;
	}
}

static const uint8_t tx_buf[] = "uart async tx-rx sample";
static uint8_t rx_buf[sizeof(tx_buf)] __attribute__((section(".nocache"))) = {0};

int main(void)
{
	const struct device *uart_dev = DEVICE_DT_GET(DT_NODELABEL(uart1));

	if (!device_is_ready(uart_dev)) {
		LOG_ERR("uart device not ready!");
		return -1;
	}

	printk("Uart async tx-rx sample\n");

	memset(rx_buf, 0, sizeof(rx_buf));

	uart_callback_set(uart_dev, uart_async_callback, NULL);

	uart_rx_enable(uart_dev, rx_buf, sizeof(rx_buf), 50 * USEC_PER_MSEC);

	uart_tx(uart_dev, tx_buf, sizeof(tx_buf), 100 * USEC_PER_MSEC);

	if (k_sem_take(&tx_done, K_MSEC(100)) != 0) {
		LOG_ERR("TX_DONE timeout\n");
		return -1;
	}

	if (k_sem_take(&rx_rdy, K_MSEC(100)) != 0) {
		LOG_ERR("RX_RDY timeout\n");
		return -1;
	}

	if (memcmp(tx_buf, rx_buf, sizeof(rx_buf)) != 0) {
		printk("Data check failed\n");
		return -1;
	}

	printk("Uart async tx-rx complete\n");

	return 0;
}
```
