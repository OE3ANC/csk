## CMakeLists.txt
```
# SPDX-License-Identifier: Apache-2.0

cmake_minimum_required(VERSION 3.20.0)

set(SUPPORT_BOARDS csk6012_nano csk6011a_nano csk6_duomotai_devkit)
if(NOT ${BOARD} IN_LIST SUPPORT_BOARDS)
    message("Please choose one of the following boards:")
    foreach(item ${SUPPORT_BOARDS})
        message(STATUS ${item})
    endforeach()
    message(FATAL_ERROR "\nThe project does not support the ${BOARD}")
endif()

find_package(Zephyr REQUIRED HINTS $ENV{ZEPHYR_BASE})
project(hwinfo)

target_sources(app PRIVATE src/main.c)
```

## sample.yaml
```
tests:
  sample.board.csk6.driver.hwinfo:
    platform_allow: csk6011a_nano csk6_duomotai_devkit
    tags: csk6
    harness: console
    harness_config:
      type: one_line
      regex:
        - "get device id success"
```

## prj.conf
```kconfig
CONFIG_HWINFO=y
```

## src/main.c
```c
/*
 * Copyright (c) 2023 Anhui(Shenzhen) Listenai Co., Ltd.
 *
 * SPDX-License-Identifier: Apache-2.0
 */

#include <zephyr/kernel.h>
#include <zephyr/device.h>
#include <zephyr/devicetree.h>
#include <zephyr/drivers/hwinfo.h>
#include <string.h>


int main(void)
{
    uint32_t buffer[3] = {0};
    uint64_t chip_id = 0;
    uint32_t chip_type = 0;
    size_t length = 0;

    length = hwinfo_get_device_id((uint8_t *)&buffer, sizeof(buffer));

    if(length != sizeof(buffer)){
        printk("length error (%d)\n", length);
        return -1;
    }

    memcpy((void*)&chip_id, (void*)buffer, sizeof(chip_id));

    printk("chip id: 0x%llx\n", chip_id);

    memcpy((void*)&chip_type, (void*)&buffer[2], sizeof(chip_type));

    printk("chip type: %x\n", chip_type);

    printk("get device id success\n");

    return 0;
}
```
