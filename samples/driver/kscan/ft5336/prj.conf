## CMakeLists.txt
```
# SPDX-License-Identifier: Apache-2.0

cmake_minimum_required(VERSION 3.20.0)

set(SUPPORT_BOARDS csk6_duomotai_devkit)
if(NOT ${BOARD} IN_LIST SUPPORT_BOARDS)
    message("Please choose one of the following boards:")
    foreach(item ${SUPPORT_BOARDS})
        message(STATUS ${item})
    endforeach()
    message(FATAL_ERROR "\nThe project does not support the ${BOARD}")
endif()

find_package(Zephyr HINTS $ENV{ZEPHYR_BASE})
project(KSCAN)

target_sources(app PRIVATE src/main.c)
```

## sample.yaml
```
tests:
  samples.boards.csk6.driver.kscan.ft5336:
    platform_allow: csk6_duomotai_devkit
    tags: csk6
    build_only: true
    harness: console
    harness_config:
      type: one_line
      regex:
        - "ft5336 sample application start"
```

## prj.conf
```kconfig
CONFIG_LOG=y
CONFIG_GPIO=y
CONFIG_I2C=y
CONFIG_KSCAN=y
CONFIG_KSCAN_FT5336=y
CONFIG_KSCAN_FT5336_INTERRUPT=y
```

## src/main.c
```c
/*
 * Copyright (c) 2023 Anhui(Shenzhen) Listenai Co., Ltd.
 *
 * SPDX-License-Identifier: Apache-2.0
 */

#include <zephyr/drivers/gpio.h>
#include <zephyr/drivers/kscan.h>
#include <soc.h>
#include <zephyr/sys/printk.h>
#include <zephyr/kernel.h>
#include <zephyr/drivers/i2c.h>

static void kb_callback(const struct device *dev, uint32_t row, uint32_t col, bool pressed)
{
	ARG_UNUSED(dev);

	printk("Key row = %d col = %d Pressed = %u\n", row, col, pressed);
}

int main(void)
{
	const struct device *kscan_dev = DEVICE_DT_GET(DT_NODELABEL(ft5336));
	int ret = 0;

	if (!device_is_ready(kscan_dev)) {
		printk("kscan device  not ready \n");
		return -1;
	}

	ret = kscan_config(kscan_dev, kb_callback);
	if (ret != 0) {
		printk("kscan config error \n");
		return -1;
	}
	kscan_enable_callback(kscan_dev);

	printk("ft5336 sample application start\n");

	return 0;
}
```
