## CMakeLists.txt
```
# SPDX-License-Identifier: Apache-2.0

cmake_minimum_required(VERSION 3.20.0)

set(SUPPORT_BOARDS csk6_duomotai_devkit)
if(NOT ${BOARD} IN_LIST SUPPORT_BOARDS)
    message("Please choose one of the following boards:")
    foreach(item ${SUPPORT_BOARDS})
        message(STATUS ${item})
    endforeach()
    message(FATAL_ERROR "\nThe project does not support the ${BOARD}")
endif()

find_package(Zephyr REQUIRED HINTS $ENV{ZEPHYR_BASE})
project(pwm)

target_sources(app PRIVATE src/main.c)
```

## sample.yaml
```
sample:
  name: PWM sample
tests:
  csk.samples.driver.pwm:
    platform_allow: csk6_duomotai_devkit
    tags: csk6
    build_only: true
```

## prj.conf
```kconfig
CONFIG_PWM=y
CONFIG_PWM_CSK6_CH32V003=n
CONFIG_I2C=y
CONFIG_PWM_CSK6=y
```

## boards/csk6_duomotai_devkit.overlay
```dts
/*
 * Copyright (c) 2023 Anhui(Shenzhen) Listenai Co., Ltd.
 *
 * SPDX-License-Identifier: Apache-2.0
 */
/{

};


&gptchannel2 {
    compatible = "listenai,csk-pwm";

    status = "okay";
    channel_mode = <1>;  /* 0: timer; 1:pwm */

    clock-prescaler = <128>;
    pinctrl-0 = <&pinctrl_pwm2_default>;
    pinctrl-names = "default";

};
/{
    pwms {
        compatible = "pwm-leds";
        inter_pwm: inter_pwm {
                /* PWM LED will conflict with User LED1 since using the same gpio pin */
                pwms = <&gptchannel2 2 PWM_MSEC(20) PWM_POLARITY_NORMAL>;
        };

    };
};
```

## src/main.c
```c
/*
 * Copyright (c) 2023 Anhui(Shenzhen) Listenai Co., Ltd.
 *
 * SPDX-License-Identifier: Apache-2.0
 */

#include <zephyr/device.h>
#include <zephyr/devicetree.h>
#include <zephyr/drivers/gpio.h>
#include <zephyr/drivers/pwm.h>
#include <zephyr/kernel.h>


#define max_period PWM_MSEC(1U)

const struct pwm_dt_spec spec = PWM_DT_SPEC_GET(DT_NODELABEL(inter_pwm));



int main(void)
{
	if (!device_is_ready(spec.dev)) {
		printk("device: %s is not ready\n", spec.dev->name);
		return 0;
	}

	printk("name: %s \n", spec.dev->name);
	printk("channel: %d \n", spec.channel);
	printk("period: %d \n", spec.period);
	printk("flag: %d \n", spec.flags);
	if(pwm_set_dt(&spec, max_period, max_period / 2U) == 0){
		printk("pwm_set_dt success\n");
	}
	k_sleep(K_SECONDS(4U));
	while(1){}
	return 0;
}
```
