## samples/driver/video/dvp/sample.yaml
```yaml
tests:
  sample.board.csk6.driver.video.dvp:
    platform_allow: csk6011a_nano
    tags: csk6
    build_only: true
```

## samples/driver/video/sco30iot/sample.yaml
```yaml
tests:
  sample.board.csk6.driver.video.sco30iot:
    platform_allow: csk6011a_nano
    tags: csk6
    build_only: true
```

## samples/driver/video/webusb_dvp/sample.yaml
```yaml
tests:
  sample.board.csk6.driver.video.webusb_dvp:
    platform_allow: csk6011a_nano
    tags: csk6
    build_only: true
```

## samples/driver/video/webusb_dvp/webusb/Kconfig
```kconfig
menu "WEBUSB Config"

	config WEBUSB 
		bool "Decide to enable webusb"
		default n
		select USB_DEVICE_STACK
		select USB_DEVICE_BOS
		help 
			This option enable the webusb library.

	if WEBUSB

		config WEBUSB_IN_EP_IDX
			int "Webusb in endpoint index"
			default 0
			range 0 6

		config WEBUSB_OUT_EP_IDX
			int "Webusb out endpoint index"
			default 1
			range 0 6

		config WEBUSB_LOG_LEVEL_DBG
			bool "Enable webusb print log"
			default n

		config USB_DEVICE_PID
			hex
			default 0x000A

		config USB_DEVICE_PRODUCT
			string "Webusb usb device product"
			default "CSK View Finder"

		choice WEBUSB_URL_TYPE
			prompt "Webusb url"
			default WEBUSB_URL_LISTENAI
			help
				This option decide the webusb url.

			config WEBUSB_URL_CUSTOM
				bool "Custom"
				select WEBUSB_URL_CUSTOM_STRING

			config WEBUSB_URL_LISTENAI
				bool "Listenai(tool.listenai.com/csk-view-finder-spd)"

			config WEBUSB_URL_LOCALHOST
				bool "Localhost(localhost:8080)"

			config WEBUSB_URL_LOCALHOST_LOOPBACK_TEST
				bool "Localhost loopback test(localhost:8080)"
			
		endchoice

		if WEBUSB_URL_CUSTOM

			config WEBUSB_URL
				string "Webusb url"
				default "" if WEBUSB_URL_CUSTOM
				default "tool.listenai.com/csk-view-finder-spd" if WEBUSB_URL_LISTENAI
				default "localhost:8080" if WEBUSB_URL_LOCALHOST
				default "localhost:8080" if WEBUSB_URL_LOCALHOST_LOOPBACK_TEST

		endif

		config WEBUSB_URL
			default "tool.listenai.com/csk-view-finder-spd" if WEBUSB_URL_LISTENAI
			default "localhost:8080" if WEBUSB_URL_LOCALHOST
			default "localhost:8080" if WEBUSB_URL_LOCALHOST_LOOPBACK_TEST

		choice WEBUSB_URL_SCHEME
			prompt "Webusb url scheme type"
			default WEBUSB_URL_SCHEME_HTTPS
			help
				This option decide the webusb url scheme.

			config WEBUSB_URL_SCHEME_HTTP
				bool "http://"

			config WEBUSB_URL_SCHEME_HTTPS
				bool "https://"

		endchoice

		config WEBUSB_URL_SCHEME_TYPE
			hex 
			default 0x00 if WEBUSB_URL_SCHEME_HTTP
			default 0x01 if WEBUSB_URL_SCHEME_HTTPS


	endif
endmenu
```

## samples/driver/wdt/sample.yaml
```yaml
sample:
  name: WDT Sample
tests:
  csk.samples.driver.wdt:
    platform_allow: csk6011a_nano csk6_duomotai_devkit
    tags: csk6
    build_only: true
```

## samples/network/wifi_scan_ap/sample.yaml
```yaml
tests:
  sample.board.csk6.network.wifi_scan_ap:
    platform_allow: csk6011a_c3_nano csk6_duomotai_devkit
    tags: csk6
    harness: console
    build_only: true
    harness_config:
      type: one_line
      regex:
        - "Scan AP list"
```

## samples/subsys/csk_malloc/sample.yaml
```yaml
sample:
  description: csk_malloc sample, the simplest Zephyr
    application
  name: csk_malloc
tests:
  sample.board.csk6.subsys.csk_malloc:
    tags: csk
    platform_allow: csk6011a_nano csk6_duomotai_devkit
    harness: console
    harness_config:
      type: multi_line
      regex:
        - "CSK Heap test complete!"
```

## samples/subsys/usb/audio/headset/sample.yaml
```yaml
sample:
  name: USB audio headset sample
tests:
  sample.board.csk6.subsys.usb.audio.headset:
    depends_on: usb_device
    build_only: true
    tags: usb
    platform_allow:
      - csk6002_9s_nano
      - csk6011a_nano
      - csk6012_nano
      - csk6_duomotai_devkit
    harness: console
    harness_config:
      type: multi_line
      ordered: true
      regex:
        - "Found USB Headset Device"
        - "USB enabled"
```

## samples/sysbuild/with_mcuboot/sample.yaml
```yaml
sample:
  description: Sample with MCUboot built through sysbuild
  name: with mcuboot
tests:
  csk.sample.sysbuild.with_mcuboot:
    sysbuild: true
    platform_allow:
      - csk6011a_nano
    tags: mcuboot
    harness: console
    harness_config:
      type: multi_line
      regex:
        - "Address of sample(.*)"
        - "Hello sysbuild with mcuboot!(.*)"
```

## soc/arm/csk6/Kconfig.soc
```kconfig
# SPDX-License-Identifier: Apache-2.0

config SOC_CSK6
	bool "SOC_CSK6"
	select ARM
	select CPU_CORTEX_M33
	select CPU_CORTEX_M_HAS_DWT
	select CPU_HAS_ARM_SAU
	select CPU_HAS_FPU
	select CPU_HAS_MPU
	select CPU_HAS_ARM_MPU
	select ARMV8_M_DSP
	select CPU_CORTEX_M_HAS_SYSTICK
	select HAS_CSK6
	select CPU_HAS_CUSTOM_FIXED_SOC_MPU_REGIONS
	select ARCH_HAS_NOCACHE_MEMORY_SUPPORT
	select BUILD_OUTPUT_HEX
	select PLATFORM_SPECIFIC_INIT
	select PINCTRL
	select CPU_HAS_DCACHE
	select CPU_HAS_ICACHE

config HAS_CSK6
	bool
	select HAS_CMSIS_CORE
	depends on SOC_CSK6


if SOC_CSK6
	config CSK6_ICACHE
		bool "Enable CSK6 ICACHE"
		default y
		help
			Enable CSK6 ICACHE
	config CSK6_DCACHE
		bool "Enable CSK6 DCACHE"
		default y
		help
			Enable CSK6 DCACHE
	config CSK6_PSRAM
		bool "Enable CSK6 PSRAM"
		default y
		help
			Enable CSK6 PSRAM

config CSK6_FATAL
	bool "Enable csk6 fatal"
	default y
	help
		Enable csk6 fatal

config CSK6_FATAL_BACKTRACE
	bool "Enable csk6 backtrace print after fatal"
	default y
	select EXTRA_EXCEPTION_INFO
	help
		Enable csk6 fatal

config CSK6_FATAL_UNHANDLE_INTERRUPT
	bool "Enable csk6 unhandle interrupt print"
	default y
	help
		Enable csk6 unhandle interrupt print

endif # SOC_CSK6
```

## soc/arm/csk6001/Kconfig.defconfig
```kconfig
# ESP32 board configuration


if SOC_CSK6001


config SOC
	default "csk6001"

config NUM_IRQS
	default 32

config HAS_CSK6001_GPT
	bool
	help
	  Set if the general purpose timer (GPT) module is present in the SoC.

endif
```

## tests/drivers/exmcu_adc/testcase.yaml
```yaml
tests:
  tests.drivers.exmcu_adc:
    tags: drivers exmcu_adc
    platform_allow: csk6_duomotai_devkit
    harness: ztest
    harness_config:
      fixture: ch32v003
    build_only: true
```

## tests/drivers/exmcu_gpio_led/testcase.yaml
```yaml
tests:
  tests.drivers.exmcu_gpio:
    tags: drivers exmcu_gpio
    build_only: true
    platform_allow: csk6_duomotai_devkit
    harness: ztest
    harness_config:
      fixture: ch32v003
```

## tests/drivers/exmcu_pwm/testcase.yaml
```yaml
tests:
  tests.drivers.exmcu_pwm:
    tags: drivers exmcu_pwm
    platform_allow: csk6_duomotai_devkit
    harness: ztest
    harness_config:
      fixture: ch32v003
```

## tests/drivers/gpio/gpio_basic_api/testcase.yaml
```yaml
tests:
  drivers.gpio.gpio_basic_api:
    tags: drivers gpio basic api
    depends_on: gpio
    platform_allow: csk6011a_nano csk6012_nano
```

## tests/drivers/kscan/kscan_api/testcase.yaml
```yaml
tests:
  drivers.kscan.kscan_api:
    tags: drivers kscan userspace
    depends_on: kscan
    platform_allow: csk6011a_nano csk6012_nano
```

## tests/drivers/pwm/pwm_api/testcase.yaml
```yaml
tests:
  drivers.pwm:
    tags: drivers csk
    platform_exclude: csk6011a_nano csk6012_nano
    depends_on: pwm
```

## tests/drivers/sdtest/testcase.yaml
```yaml
tests:
  tests.drivers.sdtest:
    depends_on: sdmmc
    tags: drivers sdmmc
    platform_allow: csk6_duomotai_devkit
    harness: ztest
    harness_config:
      fixture: sdcard
```

## tests/drivers/wdt_basic_api/testcase.yaml
```yaml
tests:
  tests.drivers.wdt:
    depends_on: watchdog
    tags: drivers watchdog
    harness: ztest
    platform_allow: csk6_duomotai_devkit
```

## tests/network/wifi/testcase.yaml
```yaml
tests:
  tests.network.wifi:
    depends_on: csk_wifi
    tags: drivers csk_wifi
    timeout: 60000
    platform_allow: csk6_duomotai_devkit
```

## tests/network/wifi_mgr_behavior/testcase.yaml
```yaml
common:
  depends_on: csk_wifi
tests:
  tests.network.wifi_mgr_behavior:
    platform_allow: csk6_duomotai_devkit
    timeout: 60000
    tags: lib wifimanager
```

## west.yml
```yaml
manifest:
  defaults:
    remote: listenai
  remotes:
    - name: listenai
      url-base: https://cloud.listenai.com/zephyr
    - name: lsf
      url-base: https://cloud.listenai.com/listenai/lsf-dev
  projects:
    - name: zephyr
      repo-path: zephyr_downstream
      revision: e7b4084f8875ea36f2ce1e3c0f9ba8bf6835d749
      import:
        name-allowlist:
          - cmsis
          - mbedtls
          - tinycrypt
          - littlefs
          - mcuboot
          - lvgl
    - name: csk6_cm33
      url: https://cloud.listenai.com/listenai/driver/csk6_cm33
      revision: 20ffba1293099ddda0ba70baa321f900634df18b
      path: modules/hal/listenai/csk6_cm33
      groups:
        - hal
    - name: protobuf-c
      remote: listenai
      revision: 7e890d56c85eae639a30acb54bb0c65b5d5ee272
      path: modules/lib/protobuf-c
    - name: esp-hosted
      remote: listenai
      revision: 77c953eecdcd023c10fae2fdf98a0350d070766a
      path: modules/lib/esp-hosted
    - name: wifi_manager
      remote: listenai
      revision: a9c986933d0805e010ecacccd3bf36bb279387f7
      path: modules/lib/wifi_manager
    - name: csk_sqlite3
      remote: listenai
      revision: cf382c66d68136866e0b7b1f385ecb196936249c
      path: modules/lib/csk_sqlite3
    - name: fatfs
      remote: listenai
      revision: 00316e7d4a41b1d4c0b492c94659b08b4fd63e9f
      path: modules/fs/fatfs
      groups:
        - fs

  self:
    path: csk
```
