/*
 * Copyright (c) 2021 listenai Intelligent Technology (anhui) Co., Ltd.
 *
 * SPDX-License-Identifier: Apache-2.0
 */
 
/delete-node/ &gc0328;

&i2c1 {
    status = "okay";
    pinctrl-0 = <&pinctrl_i2c1_scl_default &pinctrl_i2c1_sda_default>;
    pinctrl-names = "default";

	ov9655: ov9655@30 {
		compatible = "ovti,ov9655";
		status = "okay";
		reg = <0x30>;
		reset-gpios = <&gpioa 6 0>;
    };
};

&dvp {
	status = "okay";
	sensor = <&ov9655>;
	clock-prescaler = <5>;
	data-align-type = "high_align";
	pclk-polarity = "post_edge_sampling";
	hsync-polarity = "active_high";
	vsync-polarity = "active_low";

    pinctrl-0 = <
    &pinctrl_dvp_clkout_default
    &pinctrl_dvp_vsync_default
    &pinctrl_dvp_hsync_default
    &pinctrl_dvp_pclk_default
    &pinctrl_dvp_d4_default
    &pinctrl_dvp_d5_default
    &pinctrl_dvp_d6_default
    &pinctrl_dvp_d7_default
    &pinctrl_dvp_d8_default
    &pinctrl_dvp_d9_default
    &pinctrl_dvp_d10_default
    &pinctrl_dvp_d11_default
    >;
    pinctrl-names = "default";

};
