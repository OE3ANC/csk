## Kconfig
```
# Config options for http2 server sample application

# Copyright (c) 2023, Emna Rekik
# SPDX-License-Identifier: Apache-2.0

mainmenu "HTTP2 server sample application"

menu "Wifi softAP Configuration"

config EXAMPLE_WIFI_SOFTAP_SSID
	string "WiFi SSID generated by sotAP"
	default "CSK6_SoftAP"

config EXAMPLE_WIFI_SOFTAP_PASSWORD
	string "WiFi password generated by sotAP"
	default "12345678"

config EXAMPLE_WIFI_SOFTAP_CHANNEL
	int "WiFi channel"
	default 1

config EXAMPLE_WIFI_SOFTAP_MAX_CONNECTION
	int "WiFi STA max connection devices"
	default 3

config DHCP_SERVER_BASE_ADDR
	string "DHCP server base address"
	default "192.168.0.100"

endmenu

menu "Wifi STA Configuration"

    config EXAMPLE_WIFI_STA_SSID
        string "WiFi SSID to connect"
        default "listenai.com"

    config EXAMPLE_WIFI_STA_PASSWORD
        string "WiFi password to connect"
        default "Listenai@work"

endmenu

config NET_SAMPLE_HTTP_SERVICE
	bool "Enable http service"
	default y

config NET_SAMPLE_HTTP_SERVER_SERVICE_PORT
	int "Port number for http service"
	default 80
	depends on NET_SAMPLE_HTTP_SERVICE

config NET_SAMPLE_HTTPS_SERVICE
	bool "Enable https service"
	depends on NET_SOCKETS_SOCKOPT_TLS || TLS_CREDENTIALS

config NET_SAMPLE_HTTPS_SERVER_SERVICE_PORT
	int "Port number for https service"
	default 443
	depends on NET_SAMPLE_HTTPS_SERVICE

config NET_SAMPLE_PSK_HEADER_FILE
	string "Header file containing PSK"
	default "dummy_psk.h"
	depends on MBEDTLS_KEY_EXCHANGE_PSK_ENABLED
	help
	  Name of a header file containing a
	  pre-shared key.

config NET_SAMPLE_CERTS_WITH_SC
	bool "Signed certificates"
	depends on NET_SOCKETS_SOCKOPT_TLS
	help
	  Enable this flag, if you are interested to run this
	  application with signed certificates and keys.

config NET_SAMPLE_WEBSOCKET_SERVICE
	bool "Enable websocket service"
	default y if HTTP_SERVER_WEBSOCKET

config NET_SAMPLE_NUM_WEBSOCKET_HANDLERS
	int "How many websocket connections to serve at the same time"
	depends on NET_SAMPLE_WEBSOCKET_SERVICE
	default 1
	help
	  Each websocket connection is served by a thread which needs
	  memory. Only increase the value here if really needed.

source "Kconfig.zephyr"
```

## prj.conf
```kconfig
# General config
CONFIG_MAIN_STACK_SIZE=4096
CONFIG_ENTROPY_GENERATOR=y
CONFIG_TEST_RANDOM_GENERATOR=y
CONFIG_INIT_STACKS=y
CONFIG_ZVFS_OPEN_MAX=32
CONFIG_POSIX_API=y
CONFIG_FDTABLE=y
CONFIG_HEAP_MEM_POOL_SIZE=60000
CONFIG_SYSTEM_WORKQUEUE_STACK_SIZE=4096
CONFIG_INIT_STACKS=y
CONFIG_NEWLIB_LIBC=y

CONFIG_LOG=y
CONFIG_LOG_PRINTK=y
CONFIG_LOG_MODE_IMMEDIATE=y
CONFIG_WIFI_LOG_LEVEL_DBG=y

CONFIG_SHELL=y

CONFIG_NET_SOCKETS_POLL_MAX=32

# Eventfd
CONFIG_EVENTFD=y
CONFIG_EVENTFD_MAX=3
CONFIG_ZVFS_EVENTFD_MAX=64

# Networking config
CONFIG_NETWORKING=y
CONFIG_NET_IPV4=y
CONFIG_NET_IPV6=n
CONFIG_NET_TCP=y
CONFIG_NET_SOCKETS=y
CONFIG_NET_CONNECTION_MANAGER=y
CONFIG_NET_SHELL=y
CONFIG_NET_LOG=y

# HTTP parser
CONFIG_HTTP_PARSER_URL=y
CONFIG_HTTP_PARSER=y
CONFIG_HTTP_SERVER=y
CONFIG_HTTP_SERVER_WEBSOCKET=y

# Network buffers
CONFIG_NET_PKT_RX_COUNT=16
CONFIG_NET_PKT_TX_COUNT=16
CONFIG_NET_BUF_RX_COUNT=128
CONFIG_NET_BUF_TX_COUNT=128
CONFIG_NET_CONTEXT_NET_PKT_POOL=y

# IP address options
CONFIG_NET_IF_UNICAST_IPV6_ADDR_COUNT=3
CONFIG_NET_IF_MCAST_IPV6_ADDR_COUNT=4
CONFIG_NET_MAX_CONTEXTS=32
CONFIG_NET_MAX_CONN=32

# Network address config
CONFIG_NET_CONFIG_SETTINGS=y
CONFIG_NET_CONFIG_NEED_IPV4=y
CONFIG_NET_CONFIG_NEED_IPV6=y
CONFIG_DHCP_SERVER_BASE_ADDR="192.168.2.100"
CONFIG_NET_CONFIG_MY_IPV4_ADDR="192.168.2.1"
CONFIG_NET_CONFIG_PEER_IPV4_ADDR="192.0.2.2"
CONFIG_NET_CONFIG_MY_IPV4_GW="192.168.2.1"
CONFIG_NET_CONFIG_MY_IPV6_ADDR="2001:db8::1"
CONFIG_NET_CONFIG_PEER_IPV6_ADDR="2001:db8::2"

CONFIG_NET_SOCKETS_SERVICE_STACK_SIZE=4096


# TLS configuration
CONFIG_MBEDTLS=y
CONFIG_MBEDTLS_BUILTIN=y
CONFIG_MBEDTLS_ENABLE_HEAP=y
CONFIG_MBEDTLS_HEAP_SIZE=60000
CONFIG_MBEDTLS_SSL_MAX_CONTENT_LEN=2048
CONFIG_MBEDTLS_USE_PSA_CRYPTO=n
CONFIG_NET_SOCKETS_SOCKOPT_TLS=y
CONFIG_NET_SOCKETS_TLS_MAX_CONTEXTS=6
CONFIG_TLS_CREDENTIALS=y
CONFIG_TLS_MAX_CREDENTIALS_NUMBER=5

# Networking tweaks
# Required to handle large number of consecutive connections,
# e.g. when testing with ApacheBench.
CONFIG_NET_TCP_TIME_WAIT_DELAY=0

# WIFI
CONFIG_WIFI=y
CONFIG_CSK_WIFI_SOFTAP=y
CONFIG_NET_L2_ETHERNET=y

CONFIG_NET_DHCPV4=y
CONFIG_NET_DHCPV4_SERVER=y
CONFIG_NET_IPV4=y
CONFIG_NET_SOCKETS=y
# CONFIG_NET_SOCKETS_POSIX_NAMES=y

CONFIG_NET_MGMT=y
CONFIG_NET_MGMT_EVENT=y
CONFIG_NET_MGMT_EVENT_STACK_SIZE=4096

CONFIG_NET_RX_STACK_SIZE=2048
CONFIG_NET_TX_STACK_SIZE=2048
CONFIG_NET_PKT_RX_COUNT=16
CONFIG_NET_PKT_TX_COUNT=16
CONFIG_NET_BUF_RX_COUNT=64
CONFIG_NET_BUF_TX_COUNT=64
CONFIG_NET_TCP_WORKQ_STACK_SIZE=2048
CONFIG_NET_CONTEXT_NET_PKT_POOL=y
```

## src/main.c
```c
/*
 * Copyright (c) 2023, Emna Rekik
 * Copyright (c) 2024, Nordic Semiconductor
 *
 * SPDX-License-Identifier: Apache-2.0
 */

#include <stdio.h>
#include <string.h>

#include <zephyr/kernel.h>
#include <zephyr/net/tls_credentials.h>
#include <zephyr/net/http/server.h>
#include <zephyr/net/http/service.h>
#include <zephyr/net/net_if.h>
#include <zephyr/net/net_ip.h>
#include <zephyr/net/socket.h>
#include <zephyr/net/dhcpv4_server.h>

#include <zephyr/logging/log.h>
LOG_MODULE_REGISTER(net_http_server_sample, LOG_LEVEL_DBG);

struct app_msg {
	uint32_t id;
	uint32_t len;
	void *data;
};

K_MSGQ_DEFINE(app_msgq, sizeof(struct app_msg), 4, 4);

static uint8_t index_html_gz[] = {
#include "index.html.gz.inc"
};

static uint16_t test_http_service_port = CONFIG_NET_SAMPLE_HTTP_SERVER_SERVICE_PORT;
HTTP_SERVICE_DEFINE(test_http_service, CONFIG_NET_CONFIG_MY_IPV4_ADDR, &test_http_service_port, 1,
		    10, NULL);

struct http_resource_detail_static index_html_gz_resource_detail = {
	.common = {
			.type = HTTP_RESOURCE_TYPE_STATIC,
			.bitmask_of_supported_http_methods = BIT(HTTP_GET),
			.content_encoding = "gzip",
			.content_type = "text/html",
		},
	.static_data = index_html_gz,
	.static_data_len = sizeof(index_html_gz),
};

HTTP_RESOURCE_DEFINE(index_html_gz_resource, test_http_service, "/",
		     &index_html_gz_resource_detail);

static uint8_t recv_buffer[1024];

static int dyn_handler(struct http_client_ctx *client, enum http_data_status status,
		       uint8_t *buffer, size_t len, void *user_data)
{
#define MAX_TEMP_PRINT_LEN 32
	static char print_str[MAX_TEMP_PRINT_LEN];
	enum http_method method = client->method;
	static size_t processed;

	__ASSERT_NO_MSG(buffer != NULL);

	if (status == HTTP_SERVER_DATA_ABORTED) {
		LOG_DBG("Transaction aborted after %zd bytes.", processed);
		processed = 0;
		return 0;
	}

	processed += len;

	snprintf(print_str, sizeof(print_str), "%s received (%zd bytes)",
		 http_method_str(method), len);
	LOG_HEXDUMP_DBG(buffer, len, print_str);

	if (status == HTTP_SERVER_DATA_FINAL) {
		LOG_DBG("All data received (%zd bytes).", processed);
		struct app_msg msg;
		char *msg_datas = k_malloc(processed + 1);
		if (msg_datas == NULL) {
			LOG_ERR("msg datas buffer alloc failed");
			processed = 0;
			return len;
		}
		memset(msg_datas, 0, processed + 1);
		memcpy(msg_datas, recv_buffer, processed);
		msg.data = msg_datas;
		msg.len = processed;
		msg.id = 0;
		k_msgq_put(&app_msgq, &msg, K_FOREVER);
		processed = 0;
	}

	/* This will echo data back to client as the buffer and recv_buffer
	 * point to same area.
	 */
	return len;
}

struct http_resource_detail_dynamic dyn_resource_detail = {
	.common = {
		.type = HTTP_RESOURCE_TYPE_DYNAMIC,
		.bitmask_of_supported_http_methods =
			BIT(HTTP_GET) | BIT(HTTP_POST),
	},
	.cb = dyn_handler,
	.data_buffer = recv_buffer,
	.data_buffer_len = sizeof(recv_buffer),
	.user_data = NULL,
};

HTTP_RESOURCE_DEFINE(dyn_resource, test_http_service, "/submit", &dyn_resource_detail);

extern int wifi_init(void);
extern int wifi_softAP_start(void);
extern int wifi_sta_connect(const char *ssid, const char *pwd);
extern int wifi_softAP_stop(void);
struct http_cfg_msg {
	uint8_t ssid[32];
	uint8_t pwd[32];
	uint8_t auth[32];
};

static int parse_http_cfg_msg(const char *msg, struct http_cfg_msg *cfg)
{
	sscanf(msg, "ssid=%31[^&]&password=%31[^&]&auth=%31s", cfg->ssid, cfg->pwd, cfg->auth);

	return 0;
}

int main(void)
{
	wifi_init();

	struct net_if *iface = net_if_get_default();

	if (!iface) {
		LOG_ERR("No such interface in index %d", 1);
		return -1;
	}

	struct in_addr my_addr4;
	struct in_addr my_netmask4;

	net_addr_pton(AF_INET, CONFIG_NET_CONFIG_MY_IPV4_ADDR, &my_addr4);
	net_addr_pton(AF_INET, CONFIG_NET_CONFIG_MY_IPV4_NETMASK, &my_netmask4);

	net_if_ipv4_addr_add(iface, &my_addr4, NET_ADDR_AUTOCONF, 0);
	net_if_ipv4_set_netmask_by_addr(iface, &my_addr4, &my_netmask4);


	wifi_softAP_start();

	k_msleep(3000);

	struct in_addr base_addr;

	net_addr_pton(AF_INET, CONFIG_DHCP_SERVER_BASE_ADDR, &base_addr);
	net_dhcpv4_server_start(iface, &base_addr);

	http_server_start();

	struct app_msg msg;
	struct http_cfg_msg cfg_msg;

	k_msgq_get(&app_msgq, &msg, K_FOREVER);

	if (msg.data == NULL) {
		LOG_ERR("recv null message");
		return -1;
	}

	parse_http_cfg_msg(msg.data, &cfg_msg);
	LOG_INF("msg: %s", (char *)msg.data);
	LOG_INF("config msg, ssid:%s, pwd:%s, auth:%s", cfg_msg.ssid, cfg_msg.pwd, cfg_msg.auth);

	wifi_softAP_stop();
	http_server_stop();
	net_if_ipv4_addr_rm(iface, &my_addr4);
	wifi_sta_connect(cfg_msg.ssid, cfg_msg.pwd);

	k_free(msg.data);

	return 0;
}
```

## src/wifi.c
```c
/*
 * Copyright (c) 2023 Anhui(Shenzhen) Listenai Co., Ltd.
 *
 * SPDX-License-Identifier: Apache-2.0
 */

#include "csk6/csk_wifi.h"
#include "zephyr/kernel.h"

#include <stdlib.h>
#include <string.h>

#include <zephyr/logging/log.h>
#include <zephyr/net/net_context.h>
#include <zephyr/net/net_core.h>
#include <zephyr/net/net_if.h>
#include <zephyr/net/net_mgmt.h>
#include <zephyr/sys/sys_heap.h>
LOG_MODULE_REGISTER(wifi_app, LOG_LEVEL_DBG);

static csk_wifi_event_cb_t wifi_event_cb;
static struct net_mgmt_event_callback dhcp_cb;
K_SEM_DEFINE(ip_got_sem, 0, 1);

static void handler_cb(struct net_mgmt_event_callback *cb, uint32_t mgmt_event,
		       struct net_if *iface)
{
	if (mgmt_event != NET_EVENT_IPV4_DHCP_BOUND) {
		return;
	}

	char buf[NET_IPV4_ADDR_LEN];

	LOG_INF("Your address: %s",
		net_addr_ntop(AF_INET, &iface->config.dhcpv4.requested_ip, buf, sizeof(buf)));
	LOG_INF("Lease time: %u seconds", iface->config.dhcpv4.lease_time);
	LOG_INF("Router: %s", net_addr_ntop(AF_INET, &iface->config.ip.ipv4->gw, buf, sizeof(buf)));
	k_sem_give(&ip_got_sem);
}

static void wifi_event_handler(csk_wifi_event_t events, void *event_data, uint32_t data_len,
			       void *arg)
{
	if (events & CSK_WIFI_EVT_AP_STARTED) {
		LOG_INF("[WiFi softap] started");
	} else if (events & CSK_WIFI_EVT_AP_STOPPED) {
		LOG_INF("[WiFi softap] stopped");
	} else if (events & CSK_WIFI_EVT_AP_STACONNECTED) {
		LOG_INF("[WiFi softap] station joined");
	} else if (events & CSK_WIFI_EVT_AP_STADISCONNECTED) {
		LOG_INF("[WiFi softap] station left");
	}
}


int wifi_init(void)
{
	csk_wifi_init(); // init will set wifi to default mode


	wifi_event_cb.handler = &wifi_event_handler;
	wifi_event_cb.events = CSK_WIFI_EVT_AP_STARTED | CSK_WIFI_EVT_AP_STOPPED |
			       CSK_WIFI_EVT_AP_STACONNECTED | CSK_WIFI_EVT_AP_STADISCONNECTED |
			       CSK_WIFI_EVT_STA_CONNECTED | CSK_WIFI_EVT_STA_DISCONNECTED;
	wifi_event_cb.arg = NULL;
	csk_wifi_add_callback(&wifi_event_cb);

	return 0;
}


int wifi_sta_connect(char *ssid, char *pwd)
{
	int ret;
	uint8_t mac_addr[6] = {0};
	csk_wifi_result_t wifi_result;
	csk_wifi_mode_set(CSK_WIFI_MODE_STA, &wifi_result, K_FOREVER);
	if (wifi_result != CSK_WIFI_SUCCESS) {
		k_panic();
	}

	ret = csk_wifi_get_mac(CSK_WIFI_MODE_STA, mac_addr);
	if (ret != 0) {
		LOG_INF("wifi get mac failed, ret: %d", ret);
		return 0;
	}
	LOG_INF("wifi station mac addr: %x:%x:%x:%x:%x:%x", mac_addr[0], mac_addr[1], mac_addr[2],
		mac_addr[3], mac_addr[4], mac_addr[5]);

	csk_wifi_sta_config_t sta_config = {0};
	sta_config.encryption_mode = CSK_WIFI_AUTH_WPA2_PSK;
	strcpy(sta_config.ssid, ssid);
	strcpy(sta_config.pwd, pwd);

	int retry_count = 0;

	do {
		LOG_INF("connecting to wifi: %s ...", sta_config.ssid);
		ret = csk_wifi_sta_connect(&sta_config, &wifi_result, K_FOREVER);
		if (ret == 0) {
			break;
		} else {
			if (wifi_result == CSK_WIFI_ERR_STA_FAILED) {
				retry_count++;
				LOG_INF("retry to connecting wifi ... %d", retry_count);
			} else {
				LOG_INF("AP not found or invalid password");
				return 0;
			}
		}
	} while (retry_count < 10);
	LOG_INF("wifi connected, ssid: %s, bssid: %s, channel: %d , rssi: %d", sta_config.ssid,
		sta_config.bssid, sta_config.channel, sta_config.rssi);
	net_mgmt_init_event_callback(&dhcp_cb, handler_cb, NET_EVENT_IPV4_DHCP_BOUND);
	net_mgmt_add_event_callback(&dhcp_cb);

	struct net_if *iface = net_if_get_default();
	if (!iface) {
		LOG_INF("wifi interface not available");
		return 0;
	}
	LOG_INF("dhcpv4 start");
	net_dhcpv4_start(iface);
	LOG_INF("Waiting for got IP address");
	k_sem_take(&ip_got_sem, K_FOREVER);

	return 0;
}

int wifi_softAP_start(void)
{
	csk_wifi_result_t wifi_result;
	LOG_INF("set to softAP mode");
	csk_wifi_mode_set(CSK_WIFI_MODE_AP, &wifi_result, K_FOREVER);
	if (wifi_result != CSK_WIFI_SUCCESS) {
		k_panic();
	}

	int ret;
	uint8_t mac_addr[6] = {0};

	ret = csk_wifi_get_mac(CSK_WIFI_MODE_AP, mac_addr);
	if (ret != 0) {
		LOG_INF("wifi get mac failed, ret: %d", ret);
		return 1;
	}
	LOG_INF("wifi softAP mac addr: %x:%x:%x:%x:%x:%x", mac_addr[0], mac_addr[1], mac_addr[2],
		mac_addr[3], mac_addr[4], mac_addr[5]);


	csk_wifi_softap_config_t ap_config = {
		.ssid = CONFIG_EXAMPLE_WIFI_SOFTAP_SSID,
		.pwd = CONFIG_EXAMPLE_WIFI_SOFTAP_PASSWORD,
		.encryption_mode = CSK_WIFI_AUTH_WPA2_PSK,
		.bandwidth = CSK_WIFI_BW_HT40,
		.channel = CONFIG_EXAMPLE_WIFI_SOFTAP_CHANNEL,
		.max_connections = CONFIG_EXAMPLE_WIFI_SOFTAP_MAX_CONNECTION,
	};
	LOG_INF("start softAP mode");
	csk_wifi_ap_start(&ap_config, &wifi_result, K_FOREVER);

	if (wifi_result == CSK_WIFI_ERR_AP_FAILED) {
		abort();
	}
	LOG_INF("ssid: %s password: %s", ap_config.ssid, ap_config.pwd);



	return 0;
}

int wifi_softAP_stop(void)
{
	csk_wifi_result_t wifi_result;
	csk_wifi_ap_stop(&wifi_result, K_FOREVER);
	if (wifi_result != CSK_WIFI_SUCCESS) {
		k_panic();
	}

	return 0;
}
```
