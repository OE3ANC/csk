## sample.yaml
```
tests:
  sample.board.csk6.network.wifi_softap_sta:
    platform_allow: csk6011a_c3_nano csk6_duomotai_devkit
    build_only: true
    tags: csk6
```

## prj.conf
```kconfig
CONFIG_WIFI=y
CONFIG_CSK_WIFI_SOFTAP=y
CONFIG_NET_L2_ETHERNET=y

CONFIG_NEWLIB_LIBC=y

CONFIG_NETWORKING=y
CONFIG_NET_DHCPV4=y
CONFIG_NET_IPV4=y
CONFIG_NET_SOCKETS=y

CONFIG_NET_MGMT=y
CONFIG_NET_MGMT_EVENT=y
CONFIG_NET_MGMT_EVENT_STACK_SIZE=4096

CONFIG_NET_RX_STACK_SIZE=15360
CONFIG_NET_TX_STACK_SIZE=15360
CONFIG_NET_PKT_RX_COUNT=16
CONFIG_NET_PKT_TX_COUNT=16
CONFIG_NET_BUF_RX_COUNT=64
CONFIG_NET_BUF_TX_COUNT=64
CONFIG_NET_CONTEXT_NET_PKT_POOL=y

CONFIG_HEAP_MEM_POOL_SIZE=20480
CONFIG_SYSTEM_WORKQUEUE_STACK_SIZE=5120
CONFIG_SYSTEM_WORKQUEUE_PRIORITY=-1
CONFIG_MAIN_STACK_SIZE=4096
CONFIG_INIT_STACKS=y
CONFIG_POSIX_API=y
```

## src/main.c
```c
/*
 * Copyright (c) 2023 Anhui(Shenzhen) Listenai Co., Ltd.
 *
 * SPDX-License-Identifier: Apache-2.0
 */
#include <stdlib.h>
#include <zephyr/kernel.h>
#include <zephyr/sys/printk.h>

#include <zephyr/net/net_if.h>
#include <zephyr/net/net_core.h>
#include <zephyr/net/net_context.h>
#include <zephyr/net/net_mgmt.h>

#include "csk6/csk_wifi.h"

static csk_wifi_event_cb_t wifi_event_cb;

static void wifi_event_handler(csk_wifi_event_t events, void *event_data, uint32_t data_len, void *arg)
{
    if (events & CSK_WIFI_EVT_AP_STARTED) {
        printk("[WiFi softap] started\n");
    } else if (events & CSK_WIFI_EVT_AP_STOPPED) {
        printk("[WiFi softap] stopped\n");
    } else if (events & CSK_WIFI_EVT_AP_STACONNECTED) {
        printk("[WiFi softap] station joined\n");
    } else if (events & CSK_WIFI_EVT_AP_STADISCONNECTED) {
        printk("[WiFi softap] station left\n");
    }
}

int main(void)
{
    csk_wifi_init();
    wifi_event_cb.handler = &wifi_event_handler;
    wifi_event_cb.events = CSK_WIFI_EVT_AP_STARTED |
                            CSK_WIFI_EVT_AP_STOPPED |
                            CSK_WIFI_EVT_AP_STACONNECTED |
                            CSK_WIFI_EVT_AP_STADISCONNECTED;
    wifi_event_cb.arg = NULL;
    csk_wifi_add_callback(&wifi_event_cb);

    csk_wifi_softap_config_t ap_config = {
        .ssid = CONFIG_EXAMPLE_WIFI_SSID,
        .pwd = CONFIG_EXAMPLE_WIFI_PASSWORD,
        .encryption_mode = CSK_WIFI_AUTH_WPA2_PSK, /* TODO: add to menuconfig */
        .bandwidth = CSK_WIFI_BW_HT40,
        .channel = CONFIG_EXAMPLE_WIFI_CHANNEL,
        .max_connections = CONFIG_EXAMPLE_WIFI_MAX_CONNECTTION,
    };

    csk_wifi_result_t wifi_result;
    csk_wifi_ap_start(&ap_config, &wifi_result, K_FOREVER);

    if (wifi_result == CSK_WIFI_ERR_AP_FAILED) {
        abort();
    }
    printk("ssid: %s password: %s\n", ap_config.ssid, ap_config.pwd);
    return 0;
}
```
