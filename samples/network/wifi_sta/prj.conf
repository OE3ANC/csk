## CMakeLists.txt
```
# SPDX-License-Identifier: Apache-2.0

cmake_minimum_required(VERSION 3.20.0)

set(SUPPORT_BOARDS csk6012_c3_nano csk6011a_c3_nano csk6_duomotai_devkit)
if(NOT ${BOARD} IN_LIST SUPPORT_BOARDS)
    message("Please choose one of the following boards:")
    foreach(item ${SUPPORT_BOARDS})
        message(STATUS ${item})
    endforeach()
    message(FATAL_ERROR "\nThe project does not support the ${BOARD}")
endif()

find_package(Zephyr REQUIRED HINTS $ENV{ZEPHYR_BASE})
project(wifi_sta)

target_sources(app PRIVATE src/main.c)
```

## Kconfig
```
# SPDX-License-Identifier: Apache-2.0

menu "Example Configuration"

    config EXAMPLE_WIFI_SSID
        string "WiFi SSID"
        default "listenai.com"

    config EXAMPLE_WIFI_PASSWORD
        string "WiFi password"
        default "Listenai@work"

endmenu

source "Kconfig.zephyr"
```

## sample.yaml
```
tests:
  sample.board.csk6.network.wifi_sta:
    platform_allow: csk6011a_c3_nano csk6_duomotai_devkit
    build_only: true
    tags: csk6
```

## prj.conf
```kconfig
CONFIG_WIFI=y
CONFIG_CSK_WIFI_STATION=y
CONFIG_NET_L2_ETHERNET=y

CONFIG_NETWORKING=y
CONFIG_NET_DHCPV4=y
CONFIG_NET_IPV4=y
CONFIG_NET_SOCKETS=y

CONFIG_NET_MGMT=y
CONFIG_NET_MGMT_EVENT=y
CONFIG_NET_MGMT_EVENT_STACK_SIZE=4096

CONFIG_NET_RX_STACK_SIZE=2048
CONFIG_NET_TX_STACK_SIZE=2048
CONFIG_NET_PKT_RX_COUNT=16
CONFIG_NET_PKT_TX_COUNT=16
CONFIG_NET_BUF_RX_COUNT=64
CONFIG_NET_BUF_TX_COUNT=64
CONFIG_NET_CONTEXT_NET_PKT_POOL=y

CONFIG_NEWLIB_LIBC=y
CONFIG_POSIX_API=y

CONFIG_SYSTEM_WORKQUEUE_STACK_SIZE=2048
CONFIG_HEAP_MEM_POOL_SIZE=35840
CONFIG_MAIN_STACK_SIZE=4096
CONFIG_INIT_STACKS=y

CONFIG_LOG=y
CONFIG_WIFI_LOG_LEVEL_DBG=y
```

## src/main.c
```c
/*
 * Copyright (c) 2023 Anhui(Shenzhen) Listenai Co., Ltd.
 *
 * SPDX-License-Identifier: Apache-2.0
 */

#include <stdlib.h>

#include <zephyr/net/net_context.h>
#include <zephyr/net/net_core.h>
#include <zephyr/net/net_if.h>
#include <zephyr/net/net_mgmt.h>
#include <zephyr/sys/printk.h>
#include <zephyr/sys/sys_heap.h>

#include "csk6/csk_wifi.h"

static csk_wifi_event_cb_t wifi_event_cb;
static struct net_mgmt_event_callback dhcp_cb;
static void handler_cb(struct net_mgmt_event_callback *cb, uint32_t mgmt_event,
		       struct net_if *iface)
{
	if (mgmt_event != NET_EVENT_IPV4_DHCP_BOUND) {
		return;
	}

	char buf[NET_IPV4_ADDR_LEN];

	struct in_addr *ip = net_if_ipv4_get_global_addr(iface, NET_ADDR_PREFERRED);

	printk("IPv4 address: %s\n",
	       net_addr_ntop(AF_INET, ip, buf, NET_IPV4_ADDR_LEN));
	printk("Lease time: %u seconds\n", iface->config.dhcpv4.lease_time);

	struct in_addr netmask = net_if_ipv4_get_netmask_by_addr(iface, ip);
	
	printk("Subnet: %s\n",
	       net_addr_ntop(AF_INET, &netmask, buf, NET_IPV4_ADDR_LEN));

	printk("Router: %s\n",
	       net_addr_ntop(AF_INET, &iface->config.ip.ipv4->gw, buf, NET_IPV4_ADDR_LEN));
}

static void wifi_event_handler(csk_wifi_event_t events, void *event_data, uint32_t data_len,
			       void *arg)
{
	if (events & CSK_WIFI_EVT_STA_CONNECTED) {
		printk("[WiFi sta] connected\n");
	} else if (events & CSK_WIFI_EVT_STA_DISCONNECTED) {
		printk("[WiFi sta] disconnected\n");
	} else {
		abort();
	}
}

int main(void)
{
	int ret;
	csk_wifi_init();
	uint8_t mac_addr[6] = {0};
	ret = csk_wifi_get_mac(CSK_WIFI_MODE_STA, mac_addr);
	if (ret != 0) {
		printk("wifi get mac failed, ret: %d\n", ret);
		return 0;
	}
	printk("wifi station mac addr: %x:%x:%x:%x:%x:%x\n", mac_addr[0], mac_addr[1], mac_addr[2],
	       mac_addr[3], mac_addr[4], mac_addr[5]);
	wifi_event_cb.handler = &wifi_event_handler;
	wifi_event_cb.events = CSK_WIFI_EVT_STA_CONNECTED | CSK_WIFI_EVT_STA_DISCONNECTED;
	wifi_event_cb.arg = NULL;
	csk_wifi_add_callback(&wifi_event_cb);

	csk_wifi_sta_config_t sta_config = {.ssid = CONFIG_EXAMPLE_WIFI_SSID,
					    .pwd = CONFIG_EXAMPLE_WIFI_PASSWORD,
					    .encryption_mode = CSK_WIFI_AUTH_WPA2_PSK};

	int retry_count = 0;
	csk_wifi_result_t wifi_result;
	do {
		printk("connecting to wifi: %s ...\n", sta_config.ssid);
		ret = csk_wifi_sta_connect(&sta_config, &wifi_result, K_FOREVER);
		if (ret == 0) {
			break;
		} else {
			if (wifi_result == CSK_WIFI_ERR_STA_FAILED) {
				retry_count++;
				printk("retry to connecting wifi ... %d\n", retry_count);
			} else {
				printk("AP not found or invalid password\n");
				return 0;
			}
		}
	} while (retry_count < 10);
	printk("--------------------------Current AP info-------------------------------\n");
	printk("ssid: %s  pwd: %s  bssid: %s  channel: %d  rssi: %d\n", sta_config.ssid,
	       sta_config.pwd, sta_config.bssid, sta_config.channel, sta_config.rssi);
	printk("------------------------------------------------------------------------\n");
	net_mgmt_init_event_callback(&dhcp_cb, handler_cb, NET_EVENT_IPV4_DHCP_BOUND);
	net_mgmt_add_event_callback(&dhcp_cb);
	struct net_if *iface = net_if_get_default();
	if (!iface) {
		printk("wifi interface not available");
		return 0;
	}
	net_dhcpv4_start(iface);
}
```
