## Kconfig.csk
```kconfig
#
# Copyright (c) 2023 listenai Intelligent Technology (anhui) Co., Ltd.
#
# SPDX-License-Identifier: Apache-2.0
#

orsource "./$(BOARD_DIR)/Kconfig.board"
orsource "./$(BOARD_DIR)/Kconfig"

menu "LISTENAI CSK"
rsource "drivers/Kconfig"
endmenu
```

## boards/arm/csk6001/Kconfig.board
```kconfig
# SPDX-License-Identifier: Apache-2.0

config BOARD_CSK6001
   bool "csk6001 Development Board"
   depends on SOC_CSK6001
```

## boards/arm/csk6001_pico/Kconfig.board
```kconfig
# SPDX-License-Identifier: Apache-2.0

config BOARD_CSK6001_PICO
   bool "csk6001 PICO Board"
   depends on SOC_CSK6001
```

## boards/arm/csk6001_pico/Kconfig.defconfig
```kconfig
if BOARD_CSK6001_PICO

config BOARD
   default "csk6001_pico"



endif # BOARD_CSK6001_PICO
```

## boards/arm/csk6001_tester/Kconfig.board
```kconfig
# SPDX-License-Identifier: Apache-2.0

config BOARD_CSK6001_TESTER
   bool "csk6001 tester Board"
   depends on SOC_CSK6001
```

## boards/arm/csk6001_tester/Kconfig.defconfig
```kconfig
if BOARD_CSK6001_TESTER

config BOARD
   default "csk6001_tester"



endif # BOARD_CSK6001_TESTER
```

## boards/arm/csk6002_c3_nano/Kconfig.board
```kconfig
# SPDX-License-Identifier: Apache-2.0

config BOARD_CSK6002_C3_NANO
   bool "csk6001 PICO Board"
   depends on SOC_CSK6001
```

## boards/arm/csk6002_c3_nano/Kconfig.defconfig
```kconfig
if BOARD_CSK6002_C3_NANO

config BOARD
   default "csk6002_c3_nano"



endif # BOARD_CSK6002_C3_NANO
```

## boards/arm/csk6011a_public/Kconfig
```kconfig
# SPDX-License-Identifier: Apache-2.0

if BOARD_CSK6011A_PUBLIC

config DRIVER_NON_BLOCK_INIT
    bool "Driver Non-Block Init"

endif #BOARD_CSK6011A_PUBLIC
```

## boards/arm/csk6011a_public/Kconfig.board
```kconfig
# SPDX-License-Identifier: Apache-2.0

config BOARD_CSK6011A_PUBLIC
   bool "csk6011a public Board"
   depends on SOC_CSK6
   select FLASH_HAS_DRIVER_ENABLED
```

## boards/arm/csk6011a_public/Kconfig.defconfig
```kconfig
if BOARD_CSK6011A_PUBLIC

config BOARD
   default "csk6011a_public"



endif # BOARD_CSK6011A_PUBLIC
```

## boards/arm/csk6012_9s_scanpen/Kconfig.board
```kconfig
# SPDX-License-Identifier: Apache-2.0

config BOARD_CSK6012_9S_SCANPEN
   bool "csk6001 PICO Board"
   depends on SOC_CSK6001
```

## boards/arm/csk6_duomotai_devkit/Kconfig.board
```kconfig
# SPDX-License-Identifier: Apache-2.0

config BOARD_CSK6_DUOMOTAI_DEVKIT
   bool "csk6_duomotai_devkit Board"
   depends on SOC_CSK6
```

## boards/arm/csk6_duomotai_devkit/Kconfig.defconfig
```kconfig
if BOARD_CSK6_DUOMOTAI_DEVKIT

config BOARD
   default "csk6_duomotai_devkit"

DT_CHOSEN_Z_PSRAM := zephyr,psram

config PSRAM_SIZE
	hex
	default "$(dt_chosen_reg_size_hex,$(DT_CHOSEN_Z_PSRAM))"

if WIFI

choice CSK_WIFI_OFFLOAD_MODULE
   prompt "WiFi Offload Module"
   default CSK_WIFI_ESP32C3

	config CSK_WIFI_ESP32C3
            bool "ESP32C3"
            imply CSK6_EXMCU
            imply GPIO_CSK6_CH32V003

	config CSK_WIFI_XR819S
      bool "XR819S"

endchoice

endif # WIFI

endif # BOARD_CSK6_DUOMOTAI_DEVKIT
```

## boards/listenai/csk6011a_c3_nano/Kconfig.csk6011a_c3_nano
```kconfig
# SPDX-License-Identifier: Apache-2.0

config BOARD_CSK6011A_C3_NANO
   bool
   select SOC_CSK6011A
```

## boards/listenai/csk6012_nano/Kconfig.csk6012_nano
```kconfig
# SPDX-License-Identifier: Apache-2.0

config BOARD_CSK6012_NANO
   select SOC_CSK6012
```

## boards/listenai/csk6_duomotai_devkit/Kconfig.csk6_duomotai_devkit
```kconfig
# SPDX-License-Identifier: Apache-2.0

config BOARD_CSK6_DUOMOTAI_DEVKIT
   bool
   select SOC_CSK6011A
   imply GPIO_CSK6_CH32V003
   imply ADC_CSK6_CH32V003
   imply PWM_CSK6_CH32V003
```

## boards/listenai/csk6_duomotai_devkit/board.yml
```yaml
board:
  name: csk6_duomotai_devkit
  vendor: listenai
  socs:
    - name: csk6011a
```

## drivers/Kconfig
```kconfig
#
# Copyright (c) 2023 listenai Intelligent Technology (anhui) Co., Ltd.
#
# SPDX-License-Identifier: Apache-2.0
#

menu "CSK Device Drivers"

rsource "serial/Kconfig"

rsource "entropy/Kconfig"

rsource "gpio/Kconfig"

rsource "spi/Kconfig"

rsource "i2c/Kconfig"

rsource "pwm/Kconfig"

rsource "adc/Kconfig"

rsource "watchdog/Kconfig"

rsource "flash/Kconfig"

rsource "counter/Kconfig"

rsource "dma/Kconfig"

rsource "usb/Kconfig"

rsource "crypto/Kconfig"

rsource "wifi/Kconfig"

rsource "hwinfo/Kconfig"

rsource "kscan/Kconfig"

rsource "video/Kconfig"

rsource "misc/Kconfig"

rsource "disk/Kconfig"

rsource "pinctrl/Kconfig"

rsource "infrared/Kconfig"

rsource "display/Kconfig"

rsource "mipi_dbi/Kconfig"

endmenu
```

## drivers/adc/Kconfig.csk6
```kconfig
# CSK ADC driver configuration options

# Copyright (c) 2021 listenai Intelligent Technology (anhui) Co., Ltd.
# SPDX-License-Identifier: Apache-2.0

config ADC_CSK6
	bool "listenai CSK6 embedded controller (EC) ADC driver"
	default n
	depends on HAS_CSK6
	help
	  This option enables the ADC driver for CSK6.
	  Say y if you wish to use ADC modules on CSK6.

if ADC_CSK6

config ADC_CSK6_OUTPUT_FIXUP
	bool "Fixup ADC output"
	default n
	help
	  The raw ADC output is 0~4095, representing -3.3V~3.3V. For historical
	  reasons, this value is not shifted in the driver correctly, meaning that
	  users need to minus the raw value by 2048 at application level to get
	  the correct voltage.

	  Enable this option to get the correct voltage directly from the driver.

endif # ADC_CSK6
```

## drivers/adc/Kconfig.csk6001
```kconfig
# CSK ADC driver configuration options

# Copyright (c) 2021 listenai Intelligent Technology (anhui) Co., Ltd.
# SPDX-License-Identifier: Apache-2.0

config ADC_CSK6001
	bool "listenai CSK6001 embedded controller (EC) ADC driver"
	default y
	depends on HAS_CSK6001
	help
	  This option enables the ADC driver for CSK6001.
	  Say y if you wish to use ADC modules on CSK6001.
```
