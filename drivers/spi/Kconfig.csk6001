## drivers/spi/Kconfig.csk6001
```kconfig
# SPDX-License-Identifier: Apache-2.0

menuconfig SPI_CSK6001
	bool "CSK6001 SPI driver"
	default y
	depends on HAS_CSK6001
	help
	  Enable the csk6001 SPI driver.

if SPI_CSK6001

config SPI_CTRL_STACK_SIZE
	int "Control Task Stack Size"
	default 1024

config SPI_CTRL_PRIORITY
	int "Control Task Priority"
	default 5

config SPI_TX_DMA
	bool "Enable SPI TX DMA"
	default y
	select DMA

config SPI_RX_DMA
	bool "Enable SPI RX DMA"
	default y
	select DMA

endif #SPI_CSK6001
```

## drivers/video/Kconfig
```kconfig
# VIDEO driver configuration options

# Copyright (c) 2019 Linaro Limited
# SPDX-License-Identifier: Apache-2.0

#
# VIDEO Drivers
#
menuconfig VIDEO
	bool "VIDEO hardware support"
	help
	  Enable support for the VIDEO.

if VIDEO

config VEDIO_DIRECTION_ROTATION_HORIZONT
	bool "vedio horizontal direction rotation"
	default n

config VEDIO_DIRECTION_ROTATION_VERTICAL
	bool "vedio vertical direction rotation"
	default n

config VIDEO_INIT_PRIORITY
	int "Video initialization priority"
	default 90
	help
	  System initialization priority for video drivers.

config VIDEO_BUFFER_POOL_SZ_MAX
	int "Size of the largest buffer in the video pool"
	default 1048576

config VIDEO_BUFFER_POOL_NUM_MAX
	int "Number of maximum sized buffer in the video pool"
	default 2

config VIDEO_BUFFER_POOL_ALIGN
	int "Alignment of the video pool’s buffer"
	default 64

config VIDEO_CUSTOM_SECTION
    bool "custom video mem pool section"
    default n

config VIDEO_CUSTOM_SECTION_NAME
    string "custom video mem pool section name"
    default ""

rsource "Kconfig.csk6_dvp"

rsource "Kconfig.ov9655"

rsource "Kconfig.gc032a"

rsource "Kconfig.gc0328"

rsource "Kconfig.sco30iot"

endif # VIDEO
```

## drivers/video/Kconfig.bf30a2
```kconfig
# OV7725

# Copyright (c) 2022 listenai
# SPDX-License-Identifier: Apache-2.0

config VIDEO_BF30A2
	bool "1/15 inch QVGA CMOS Image Sensor BF30A2"
	help
	  Enable driver for BF30A2 CMOS digital image sensor device.
```

## drivers/video/Kconfig.gc0328
```kconfig
# gc0328

# SPDX-License-Identifier: Apache-2.0

config VIDEO_GC0328
	bool "GC0328 CMOS digital image sensor"
    depends on HAS_CSK6
	help
	  Enable driver for GC0328 CMOS digital image sensor devices
```

## drivers/watchdog/Kconfig.ap
```kconfig
# Microchip CSK6001 Watchdog Timer configuration

# Copyright (c) 2022 listenai
# SPDX-License-Identifier: Apache-2.0

config AP_WDT_CSK
	bool "Microchip CSK series Watchdog Timer (WDT) driver"
	default y
	help
	  Enable WDT driver for Microchip CSK MCU series.
```

## drivers/watchdog/Kconfig.csk6001
```kconfig
# Microchip CSK6001 Watchdog Timer configuration

# Copyright (c) 2022 listenai
# SPDX-License-Identifier: Apache-2.0

config WDT_CSK6001
	bool "Microchip CSK series Watchdog Timer (WDT) driver"
	default y
	help
	  Enable WDT driver for Microchip CSK MCU series.
```

## drivers/wifi/csk6001/Kconfig.csk6001
```kconfig
# Copyright 2020 Espressif Systems (Shanghai) PTE LTD

menuconfig WIFI_CSK6001
	bool "CSK6001 WiFi Driver"
	default y
	depends on HAS_CSK6001
	select PROTOBUF_C
	select ESP_HOSTED
	help
	  Enable CSK6001 SoC WiFi

if WIFI_CSK6001

config CSK_WIFI_STATION
	bool "WiFi Station Enable"

config CSK_WIFI_SOFTAP
	bool "WiFi SoftAP Enable"

config WIFI_CTRL_STACK_SIZE
	int "Control Task Stack Size"
	default 8192

config WIFI_CTRL_PRIORITY
	int "Control Task Priority"
	default 4

endif #WIFI_CSK6001
```

## dts/bindings/adc/listenai,csk-adc.yaml
```yaml
# SPDX-License-Identifier: Apache-2.0

description: CSK ADC node

compatible: "listenai,csk-adc"

include: adc-controller.yaml

properties:
    reg:
      required: true

    interrupts:
      required: true

    pinmuxs:
      type: phandle-array
      required: true
      description: pinmuxs for each channel

    pinmux-names:
      type: string-array
      required: true
      description: channel index


    "#io-channel-cells":
      const: 1

io-channel-cells:
    - input
```

## dts/bindings/gpio/listenai,csk-gpio.yaml
```yaml
description: CSK GPIO

compatible: "listenai,csk-gpio"

include: [gpio-controller.yaml, base.yaml]

properties:
    reg:
        required: true

    "#gpio-cells":
        const: 2

gpio-cells:
  - pin
  - flags
```

## dts/bindings/i2c/listenai,csk-i2c.yaml
```yaml
# SPDX-License-Identifier: Apache-2.0

description: CSK I2C node

compatible: "listenai,csk-i2c"

include: i2c-controller.yaml

properties:
    reg:
      required: true

    interrupts:
      required: true

    pinmuxs:
      type: phandle-array
      required: true
      description: SCL and SDA pinmux

    pinmux-names:
      type: string-array
      required: true
      description: I2C pins names
```

## dts/bindings/input/zephyr,adc-keys.yaml
```yaml
# Copyright (c) 2023 Anhui Listenai Co., Ltd.
# SPDX-License-Identifier: Apache-2.0

description: |
  Input driver for ADC attached resistor ladder buttons

  Example:

  #include <dt-bindings/input/input-event-codes.h>

  / {
          buttons {
                  compatible = "zephyr,adc-keys";
                  io-channels = <&adc 2>;
                  keyup-threshold-mv = <0>;

                  button_0 {
                          press-threshold-mv = <1650>, <2536>;
                          zephyr,code = <INPUT_KEY_0>;
                  };

                  button_1 {
                          press-threshold-mv = <2300>, <2536>;
                          zephyr,code = <INPUT_KEY_1>;
                  };
          };
  };

compatible: "zephyr,adc-keys"

include: kscan.yaml

properties:
  io-channels:
    type: phandle-array
    required: true
    description: Phandle to an ADC channel

  sample-period-ms:
    type: int
    default: 20
    description: |
       Sample period in milliseconds.
       If not specified defaults to 20.

  keyup-threshold-mv:
    type: int
    required: true
    description: |
      Millivolt value to which all the keys are considered up.

child-binding:
  description: ADC KEYS child node
  properties:
    press-thresholds-mv:
      type: array
      required: true
      description: |
        Array of millivolt values to consider a key pressed.
    label:
      type: string
      description: Descriptive name of the key
    zephyr,code:
      type: int
      default: 0
      description: Key code to emit.
      required: true
```

## dts/bindings/kscan/adc-keys.yaml
```yaml
# Copyright (c) 2023 Anhui Listenai Co., Ltd.
# SPDX-License-Identifier: Apache-2.0

description: ADC attached resistor ladder buttons

compatible: "adc-keys"

include: kscan.yaml

properties:
  io-channels:
    type: phandle-array
    required: true
    description: Phandle to an ADC channel

  keyup-threshold-mv:
    type: int
    required: true
    description: |
      Millivolt value to which all the keys are considered up.

  press-thresholds-mv:
    type: array
    required: true
    description: |
      Array of millivolt values for each key combinations.

      Examples:

      press-thresholds-mv = <1650 (BIT(0))>,
                            <2300 (BIT(1))>,
                            <2536 (BIT(0) | BIT(1))>;
```

## dts/bindings/kscan/listenai,csk-keysense.yaml
```yaml
# Copyright (c) 2022 listenai
# SPDX-License-Identifier: Apache-2.0

description: csk6 keysense driver

compatible: "listenai,csk-keysense"

include: kscan.yaml

properties:
    reg:
      required: true

    interrupts:
      required: true

    analogkey-trigger:
      type: array
      required: true
```

## dts/bindings/mipi-dbi/listenai,mipi-dbi-spi.yaml
```yaml
# Copyright 2023 ListenAI
# SPDX-License-Identifier: Apache-2.0

description: |
  利用CSK的DMA发送显存数据
compatible: "listenai,mipi-dbi-spi"

include: ["zephyr,mipi-dbi-spi.yaml", "pinctrl-device.yaml"]

properties:
  dma-channel:
    type: int
    required: false
    description: |
      默认为通道为0， 请注意根据项目实际使用的DMA通道进行配置

  rotate:
    type: int
    required: false
    description: |
      配置旋转的角度，当前仅仅支持0和90
      如果该值为90, 则利用DMA-SG模式，将显存中的数据搬运至SPI外设从而实现图像旋转显示
```

## dts/bindings/modem/zephyr,lte-ec718.yaml
```yaml
# Copyright (c) 2021 G-Technologies Sdn. Bhd.
# SPDX-License-Identifier: Apache-2.0

description: EC718 modem

compatible: "zephyr,lte-ec718"

include: uart-device.yaml
```

## dts/bindings/mtd/listenai,csk-nv-flash.yaml
```yaml
description: |
  LISTENAI flash memory. This binding is for the flash memory itself, not
  the flash controller peripheral. For that, see the
  "listenai,csk-flash-controller" binding.

include: soc-nv-flash.yaml

compatible: listenai,csk-nv-flash

properties:
    max-erase-time:
     type: int
     description: max erase time(millisecond) of a flash sector or page or half-page
     required: true
```

## dts/bindings/pinctrl/listenai,csk6001-pinmux.yaml
```yaml
# Copyright (c) 2020 Seagate Technology LLC
# SPDX-License-Identifier: Apache-2.0

description: LISTENAI CSK6001 pinmux (aka IOCON) node

compatible: "listenai,csk-pinmux"

include: base.yaml

properties:
    ph-reg:
      type: phandle
      required: true

    "#pinmux-cells":
      type: int
      required: true
      const: 2
      description: number of items in a pinmux specifier


pinmux-cells:
  - pin
  - function
  
```

## dts/bindings/sensor/listenai,mpu6050.yaml
```yaml
# Copyright (c) 2019 Nordic Semiconductor ASA
# SPDX-License-Identifier: Apache-2.0

description: MPU-6000 motion tracking device

compatible: "listenai,mpu6050"

include: [sensor-device.yaml, i2c-device.yaml]

properties:
  int-gpios:
    type: phandle-array
    description: |
      The INT signal default configuration is active-high.  The
      property value should ensure the flags properly describe the
      signal that is presented to the driver.
```

## dts/bindings/sensor/listenai,qmi8658c.yaml
```yaml
# Copyright (c) 2025 LISTENAI (ShenZhen) Co., Ltd.
# SPDX-License-Identifier: Apache-2.0

description: three-axis qmi8658c motion tracking device

compatible: "listenai,qmi8658c"

include: [sensor-device.yaml, i2c-device.yaml]

properties:
  int-gpios:
    type: phandle-array
    description: |
      The INT signal default configuration is active-high.  The
      property value should ensure the flags properly describe the
      signal that is presented to the driver.
  # accel-range:
  #   type: int
  #   description: |
  #     Accelerometer measurement range selection.  (e.g 2/4/8/16g)
  #     required: true
```

## dts/bindings/sensor/listenai,sc7a20h.yaml
```yaml
# Copyright (c) 2025 LISTENAI (ShenZhen) Co., Ltd.
# SPDX-License-Identifier: Apache-2.0
description: SC7A20H 3-axis accelerometer sensor

compatible: "listenai,sc7a20h"

include: [sensor-device.yaml, i2c-device.yaml]

properties:
  int-gpios:
    type: phandle-array
    required: false
    description: |
      The INT pin defaults to active low when produced by the sensor.
      The property value should ensure the flags properly describe
      the signal that is presented to the driver.
```

## dts/bindings/serial/listenai,csk-uart.yaml
```yaml
# SPDX-License-Identifier: Apache-2.0

description: Listenai UART

compatible: "listenai,csk-uart"

include: uart-controller.yaml

properties:
    reg:
      required: true

    interrupts:
      required: false

    pinmuxs:
      type: phandle-array
      required: true
      description: RX and TX pinmux
```

## dts/bindings/spi/listenai,csk-spi.yaml
```yaml
# Copyright (c) 2018, I-SENSE group of ICCS
# SPDX-License-Identifier: Apache-2.0

description: listenai csk spi controller

include: spi-controller.yaml

compatible: "listenai,csk-spi"

properties:
    reg:
      required: true

    interrupts:
      required: true

    miso-gpios:
      type: phandle-array
      required: false
      description: MISO pin

    mosi-gpios:
      type: phandle-array
      required: false
      description: MOSI pin

    sclk-gpios:
      type: phandle-array
      required: false
      description: SPI generated clock pin

    spi-max-frequency:
      type: int
      required: false
      description: spi-max-frequency
```

## dts/bindings/video/galaxyc,gc0328.yaml
```yaml
# SPDX-License-Identifier: Apache-2.0

description: GC0328 CMOS video sensor

compatible: "galaxyc,gc0328"

properties:
    reset-gpios:
      type: phandle-array
      required: false
      description: |
        The RESET pin is asserted to disable the sensor causing a hard
        reset.  The sensor receives this as an active-low signal.

    pwdn-gpios:
      type: phandle-array
      required: false
      description: |
        The PWDN pin is asserted to disable the sensor causing a power
        down.  The sensor receives this as an active-high signal.

include: i2c-device.yaml
```

## dts/bindings/watchdog/ap,watchdog.yaml
```yaml
# Copyright (c) 2022 listenai
# SPDX-License-Identifier: Apache-2.0

description: listenai ap watchdog

compatible: "listenai,ap-watchdog"

include: base.yaml

properties:
    reg:
      required: true
```
