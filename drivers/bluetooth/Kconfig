## drivers/bluetooth/Kconfig
```kconfig
# SPDX-License-Identifier: Apache-2.0

if BT

rsource "hci/Kconfig.csk6"

endif # WIFI
```

## drivers/bluetooth/hci/Kconfig.csk6
```kconfig
# Copyright 2020 Espressif Systems (Shanghai) PTE LTD

choice BT_HCI_BUS_TYPE
	prompt "Bluetooth HCI driver"

config CSK_BLE_ESP32C3
	bool "CSK-ESP32C3 BLE Driver"

endchoice

if CSK_BLE_ESP32C3

config BT_HCI_RESERVE
	int
	default 1

endif #CSK_BLE_ESP32C3
```

## drivers/counter/Kconfig.csk6001
```kconfig
# Counter driver for csk clock

# Copyright (c) 2022 LISTENAI Corp.
# SPDX-License-Identifier: Apache-2.0

config COUNTER_CSK6001
	bool "Counter driver for csk6001 RTC clock"
```

## drivers/dma/Kconfig.csk6001
```kconfig
# SPDX-License-Identifier: Apache-2.0

config DMA_CSK6001
	bool "CSK6001 DMA controller driver"
	default y
	depends on HAS_CSK6001
	help
	  Enable the csk6001 SPI driver.
```

## drivers/flash/Kconfig.csk6001
```kconfig
# Copyright (c) 2021 LISTENAI Co., Ltd.
# SPDX-License-Identifier: Apache-2.0

config SOC_FLASH_CSK6001
	bool "Listenai CSK6001 flash driver"
	default y
	select FLASH_HAS_DRIVER_ENABLED
	select FLASH_HAS_PAGE_LAYOUT
	depends on HAS_CSK6001
	help
	  Enable CSK6001 internal flash driver.

config MPU_ALLOW_FLASH_WRITE
	bool "Add MPU access to write to flash"
	help
	  Enable this to allow MPU RWX access to flash memory
```

## drivers/gpio/Kconfig.csk6001
```kconfig
# SPDX-License-Identifier: Apache-2.0

config GPIO_CSK6001
	bool "CSK6001 GPIO driver"
	default y
	depends on HAS_CSK6001
	help
	  Enable the csk6001 GPIO driver.
```

## drivers/i2c/Kconfig.csk6001
```kconfig
# CSK I2C driver configuration options

# Copyright (c) 2021 listenai Intelligent Technology (anhui) Co., Ltd.
# SPDX-License-Identifier: Apache-2.0

config I2C_CSK6001
	bool "listenai CSK6001 embedded controller (EC) I2C driver"
	default y
	depends on HAS_CSK6001
	help
	  This option enables the I2C driver for CSK6001.
	  Say y if you wish to use I2C modules on CSK6001.
	  
```

## drivers/input/Kconfig
```kconfig
# SPDX-License-Identifier: Apache-2.0

if INPUT

rsource "Kconfig.adc_keys"

endif # INPUT
```

## drivers/input/Kconfig.adc_keys
```kconfig
# Copyright (c) 2023 Anhui Listenai Co., Ltd.
# SPDX-License-Identifier: Apache-2.0

config INPUT_ADC_KEYS
	bool "Zephyr ADC Keys"
	default y
	depends on DT_HAS_ZEPHYR_ADC_KEYS_ENABLED
	help
	  Enable support for Zephyr ADC Keys.
```

## drivers/kscan/Kconfig
```kconfig
if KSCAN

rsource "Kconfig.adc"
rsource "Kconfig.csk6"
rsource "Kconfig.bl6xxx"
rsource "Kconfig.ft5336"

endif # KSCAN
```

## drivers/kscan/Kconfig.adc
```kconfig
# Copyright (c) 2023 Anhui Listenai Co., Ltd.
# SPDX-License-Identifier: Apache-2.0

config KSCAN_ADC
	bool "ADC attached resistor ladder buttons"
	depends on ADC
	help
	  Enable driver for ADC attached resistor ladder buttons.

if KSCAN_ADC

config KSCAN_ADC_PERIOD_MS
	int "Sample period"
	default 20
	help
	  Sample period in milliseconds.

endif # KSCAN_ADC
```

## drivers/lte/Kconfig
```kconfig
menuconfig LTE
	bool "LTE drivers"


if LTE

config LTE_EC718
    bool "EC718 driver"
    select NETWORKING
    select NET_SOCKETS
    select NET_OFFLOAD
    select NET_SOCKETS_OFFLOAD
    default y

endif
```

## drivers/mipi_dbi/Kconfig
```kconfig
config MIPI_DBI_SPI_CSK
	bool
	default y
	depends on DT_HAS_LISTENAI_MIPI_DBI_SPI_ENABLED
	depends on MIPI_DBI
	select SPI
	help
	  Enable support for MIPI DBI SPI driver. This driver implements
	  a MIPI-DBI mode C compatible controller using a SPI device, as well
	  as GPIO outputs for the reset and D/C signals
```

## drivers/pinmux/Kconfig.csk6001
```kconfig
# Copyright (c) 2021 listenai Systems (anhui) Co., Ltd.
# SPDX-License-Identifier: Apache-2.0

config PINMUX_CSK6001
	bool "CSK6001 PINMUX driver"
	default y
	depends on HAS_CSK6001
	help
	  Enable driver for CSK6001 PINMUX driver.
```

## drivers/pwm/Kconfig.csk6
```kconfig
# Copyright (c) 2021 listenai Systems (anhui) Co., Ltd.
# SPDX-License-Identifier: Apache-2.0

config PWM_CSK6
	bool "CSK6 PWM driver"
	depends on HAS_CSK6
	select HAS_CSK6_GPT
	select COUNTER
	select COUNTER_CSK6
	default y
	help
	  This option enables the PWM driver for CSK6. Say y if you wish to use PWM port on CSK6.

config PWM_CSK6_INIT_PRIORITY
	int "pwm csk6 init priority"
	default 51
	help
		pwm csk6 init priority
		must more than counter driver priority
```

## drivers/pwm/Kconfig.csk6001
```kconfig
# Copyright (c) 2021 listenai Systems (anhui) Co., Ltd.
# SPDX-License-Identifier: Apache-2.0

config PWM_CSK6001
	bool "CSK6001 PWM driver"
	depends on HAS_CSK6001
	select HAS_CSK6001_GPT
	default y
	help
	  This option enables the PWM driver for CSK6001. Say y if you wish to use PWM port on CSK6001.
```

## drivers/sdhc/Kconfig
```kconfig
# Copyright (c) 2021 listenai Systems (anhui) Co., Ltd.
# SPDX-License-Identifier: Apache-2.0

if SDHC

source "Kconfig.csk6"

endif # SDHC
```

## drivers/sdhc/Kconfig.csk6
```kconfig
# Copyright (c) 2021 listenai Systems (anhui) Co., Ltd.
# SPDX-License-Identifier: Apache-2.0

config CSK6_SDHC
	bool "CSK6 SDHC Driver"
	default n
	select SDHC_SUPPORTS_UHS
	select SDHC_SUPPORTS_NATIVE_MODE
	select PINCTRL
	help
	  Enable the CSK6 SD Host controller driver
```

## drivers/sensor/Kconfig
```kconfig
menu "CSK SENSOR Drivers"

rsource "mpu6050/Kconfig"

rsource "sc7a20h/Kconfig"

endmenu
```

## drivers/sensor/mpu6050/Kconfig
```kconfig
# MPU6050 Six-Axis Motion Tracking device configuration options

#Copyright (c) 2025 Anhui Listenai Co., Ltd.

# SPDX-License-Identifier: Apache-2.0

config MPU6050
	bool "MPU6050 Six-Axis Motion Tracking Device"
	default n
	depends on DT_HAS_LISTENAI_MPU6050_ENABLED
	select I2C
	help
	  Enable driver for MPU6050 I2C-based six-axis motion tracking device.

if MPU6050

config MPU6050_TRIGGER_MODE
	int "Trigger mode"
	range 0 2
	default 0
	help
	  Specify the type of triggering to be used by the driver.
	  0 - No trigger
	  1 - Global thread
	  2 - Own thread

config MPU6050_THREAD_PRIORITY
	int "Thread priority"
	depends on MPU6050_TRIGGER_MODE = 2
	default 10
	help
	  Priority of thread used by the driver to handle interrupts.

config MPU6050_THREAD_STACK_SIZE
	int "Thread stack size"
	depends on MPU6050_TRIGGER_MODE = 2
	default 1024
	help
	  Stack size of thread used by the driver to handle interrupts.

config MPU6050_ACCEL_FS
	int "Accelerometer full-scale range"
	default 2
	help
	  Magnetometer full-scale range.
	  An X value for the config represents a range of +/- X g. Valid
	  values are 2, 4, 8 and 16.

config MPU6050_GYRO_FS
	int "Gyroscope full-scale range"
	default 250
	help
	  Gyroscope full-scale range.
	  An X value for the config represents a range of +/- X degrees/second.
	  Valid values are 250, 500, 1000, 2000.

endif # MPU6050
```

## drivers/sensor/qmi8658c/Kconfig
```kconfig
# QMI8658C configuration options

# Copyright (c) 2025 Anhui(Shenzhen) Listenai Co., Ltd.
#
# SPDX-License-Identifier: Apache-2.0

config QMI8658C
    bool "QMI8658C 6-Axis IMU"
    default n
    depends on DT_HAS_LISTENAI_QMI8658C_ENABLED
    select I2C
    help
      Enable driver for QMI8658C 6-axis IMU sensor.

if QMI8658C

config QMI8658C_TRIGGER
    bool "使用中断触发模式"
    default n
    depends on GPIO
    help
      选择 Y 启用中断触发模式，选择 N 使用普通 I2C 轮询模式。
      需要正确配置 GPIO 中断引脚。

if QMI8658C_TRIGGER

choice QMI8658C_TRIGGER_MODE
    prompt "触发模式选择"
    default QMI8658C_TRIGGER_GLOBAL_THREAD
    help
      选择中断触发的处理方式。

config QMI8658C_TRIGGER_THREAD
    bool "独立线程模式"
    help
      使用独立的线程处理传感器中断事件，
      可以设置独立的优先级和栈大小。

config QMI8658C_TRIGGER_GLOBAL_THREAD
    bool "全局线程模式"
    help
      使用系统全局工作队列处理中断事件，
      与其他设备共享系统工作线程。

endchoice

config QMI8658C_THREAD_PRIORITY
    int "线程优先级"
    default 10
    depends on QMI8658C_TRIGGER_THREAD
    range 0 255
    help
      独立线程模式下的线程优先级。

config QMI8658C_THREAD_STACK_SIZE
    int "线程栈大小"
    default 1024
    depends on QMI8658C_TRIGGER_THREAD
    range 512 4096
    help
      独立线程模式下的线程栈大小。

endif # QMI8658C_TRIGGER

config QMI8658C_ACCEL_FS
    int "加速度计量程范围"
    default 2
    help
      加速度计满量程范围设置，单位为 g。
      可选值为 2、4、8、16，表示 ±2g、±4g、±8g、±16g。

endif # QMI8658C
```

## drivers/sensor/sc7a20h/Kconfig
```kconfig
# SC7A20H Three-Axis Accelerometer configuration options

# Copyright (c) 2025 Anhui(Shenzhen) Listenai Co., Ltd.
#
# SPDX-License-Identifier: Apache-2.0

config SC7A20H
	bool "SC7A20H Three-Axis Accelerometer"
	default y
	depends on DT_HAS_LISTENAI_SC7A20H_ENABLED
	select I2C
	help
	  Enable driver for SC7A20H I2C-based three-axis accelerometer.

if SC7A20H

config SC7A20H_TRIGGER
	bool "Enable trigger support"
	depends on GPIO
	help
	  Enable trigger support (interrupts) for SC7A20H accelerometer.

choice
	prompt "触发模式选择"
	default SC7A20H_TRIGGER_THREAD
	depends on SC7A20H_TRIGGER

config SC7A20H_TRIGGER_THREAD
	bool "线程模式"
	help
		使用独立线程处理传感器触发事件

config SC7A20H_TRIGGER_GLOBAL_THREAD
	bool "全局线程模式"
	help
		使用系统全局线程处理触发事件

endchoice

config SC7A20H_THREAD_PRIORITY
	int "Thread priority"
	default 10
	depends on SC7A20H_TRIGGER_THREAD
	range 0 255
	help
	  Priority of thread used by the driver to handle interrupts.

config SC7A20H_THREAD_STACK_SIZE
	int "Thread stack size"
	default 1024
	depends on SC7A20H_TRIGGER_THREAD
	range 512 4096
	help
	  Stack size of thread used by the driver to handle interrupts.

config SC7A20H_ACCEL_FS
	int "Accelerometer full-scale range"
	default 2
	help
	  Accelerometer full-scale range.
	  An X value for the config represents a range of +/- X g.
	  Valid values are 2, 4, 8 and 16.

endif # SC7A20H
```

## drivers/serial/Kconfig.csk6001
```kconfig
# SPDX-License-Identifier: Apache-2.0

config UART_CSK6001
	bool "CSK6001 UART driver"
	default y
	select SERIAL_HAS_DRIVER
	select SERIAL_SUPPORT_INTERRUPT
	select PINMUX_CSK6001
	depends on HAS_CSK6001
	help
	  Enable the csk6001 UART driver.
```
